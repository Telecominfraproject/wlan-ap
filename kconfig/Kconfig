## kconfig/Kconfig
```kconfig
mainmenu "Plume Configuration"

config USE_KCONFIG
    bool "Enable KConfig configuration"

if USE_KCONFIG
    config TARGET_NAME
        string "Device Descriptive Name"

    config TARGET_MODEL
        string "Device Model Name"

    menu "OpenSync"
        menu "Networking"
            orsource "../src/lib/osn/kconfig/Kconfig"
        endmenu
    endmenu

    menu "PML Configuration"
        menuconfig PML_TARGET
            bool "Use generic TARGET (kconfig based target configuration)"

            if PML_TARGET
                orsource "../src/lib/target/kconfig/Kconfig"
            endif

        menu "INET Configuration"
            orsource "../src/lib/inet/kconfig/Kconfig"
        endmenu

        if TARGET_MANAGER_CM
            menu "CM2 Configuration"
                orsource "../src/cm2/kconfig/Kconfig"
            endmenu
        endif

        menu "libevx Configuration"
            orsource "../src/lib/evx/kconfig/Kconfig"
        endmenu
    endmenu

    menu "Platform Configuration"
        orsource "Kconfig.platform"
        osource "../platform/*/kconfig/Kconfig.platform"
    endmenu

    menu "Vendor Configuration"
        choice VENDOR
            prompt "Vendor Selection"
            orsource "Kconfig.vendor"
            orsource "../vendor/*/kconfig/Kconfig.vendor"
        endchoice
        orsource "../vendor/*/kconfig/Kconfig"
    endmenu
endif
```

## src/lib/target/kconfig/Kconfig
```kconfig
PLUME_DIR := /usr/plume
TOOLS_DIR := $(PLUME_DIR)/tools
PLUME_BIN := $(PLUME_DIR)/bin
LM_DIR := /var/log/lm

menuconfig TARGET_MANAGER
    bool "Manager customization"
    default y
    help
        Use a kconfig based "target_manager_config[]" table. This table
        defines which managers are started by DM at startup.

        This option implements the target_manager_config[] array.

    if TARGET_MANAGER
        config TARGET_MANAGER_WM
            bool "Wireless Manager (WM2)"
            default y

        config TARGET_MANAGER_NM
            bool "Network Manager (NM2)"
            default y

        config TARGET_MANAGER_CM
            bool "Connectivity Manager (CM2)"
            default y

       config TARGET_MANAGER_SM
            bool "Statistics Manager (SM)"
            default n
            select TARGET_MANAGER_QM

        config TARGET_MANAGER_QM
            bool "Queue Manager (QM)"
            default y

       config TARGET_MANAGER_UM
            bool "Upgrade Manager (UM)"
            default n

        config TARGET_MANAGER_LM
            bool "Log Manager (LM)"
            default n

        config TARGET_MANAGER_BM
            bool "Band-steering Manager (BM)"
            default n

        config TARGET_MANAGER_FM
            bool "Flash Manager (FM)"
            default n

        config TARGET_MANAGER_LEDM
            bool "LED Manager (LEDM)"
            default n

        config TARGET_MANAGER_OM
            bool "Openflow Manager (OM)"
            default n

        config TARGET_MANAGER_BLEM
            bool "Bluetooth Manager (BLEM)"
            default n

        config TARGET_MANAGER_TM
            bool "Thermal Manager (TM)"
            default n

        config TARGET_MANAGER_FSM
            bool "Flow Service Manager (FSM)"
            default n

        config TARGET_MANAGER_FCM
            bool "Flow Collection Manager (FCM)"
            default n

        config TARGET_MANAGER_XM
            bool "Exchange Manager (XM)"
            default n

        config TARGET_MANAGER_HELLO_WORLD
            bool "Hello World Manager (hello_world)"
            default n

        config TARGET_MANAGER_PM
            bool "Platform Manager (PM)"
            default n

        config TARGET_MANAGER_PPM
            bool "Pod Manager (PPM)"
            default n

        config TARGET_MANAGER_NFM
            bool "Netfilter Manager (NFM)"
            default n

        osource "3rdparty/*/src/lib/target/kconfig/Kconfig.managers"

        osource "platform/*/src/lib/target/kconfig/Kconfig.managers"

        osource "vendor/*/src/lib/target/kconfig/Kconfig.managers"

    endif

menu "Capabilities"
    config TARGET_CAP_GATEWAY
        bool "Gateway"
        default y
        help
            This device can act as a gateway (residential or otherwisE).

    config TARGET_CAP_EXTENDER
        bool "Extender"
        default n
        select TARGET_CAP_GATEWAY
        help
            This device can act as an extender.

endmenu

menu "Target paths"
    config TARGET_PATH_BIN
        string "Path to binaries/managers"
        default "$(PLUME_BIN)"

    config TARGET_PATH_TOOLS
        string "Path to tools folder"
        default "$(PLUME_DIR)/tools"

    config TARGET_PATH_SCRIPTS
        string "Path to scripts folder"
        default "$(PLUME_BIN)"

    config TARGET_PATH_PERSISTENT
        string "Path to persistent storage"
        default "/etc/plume"

    config TARGET_PATH_LOG_STATE
        string "Path to the log state config file"
        default "/etc/log-state.conf"
        help
            On systems with buggy inotify and overlayfs (QSDK 2.0),
            use the overlay path instead (/overlay/etc/log-state.conf)

    config TARGET_PATH_LOG_LM
        string "Path to LM log storage"
        default "$(LM_DIR)"

    config TARGET_PATH_LOG_TRIGGER
        string "Path to the log trigger folder"
        default "$(LM_DIR)/tmp"
        help
            This is used for dynamically adjusting log and severity levels

    config TARGET_PATH_DISABLE_FATAL_STATE
        string "Path to the fatal state inhibit file"
        default "/opt/tb/cm-disable-fatal"
        help
            This file inhibits the manager restart action -- use for testing only.
endmenu

menuconfig TARGET_ETH_LIST
    bool "Ethernet interface list"
    default y
    help
        Use a hardcoded ethernet interface list.

        This option implements the target_ethclient_iflist_get() function.

if TARGET_ETH_LIST
    config TARGET_ETH0_LIST
        bool "Ethernet[0]"
        default y

    config TARGET_ETH0_NAME
        string "Ifname[0]"
        depends on TARGET_ETH0_LIST
        default "eth0"

    config TARGET_ETH1_LIST
        bool "Ethernet[1]"

    config TARGET_ETH1_NAME
        string "Ifname[1]"
        depends on TARGET_ETH1_LIST

    config TARGET_ETH2_LIST
        bool "Ethernet[2]"

    config TARGET_ETH2_NAME
        string "Ifname[2]"
        depends on TARGET_ETH2_LIST

    config TARGET_ETH3_LIST
        bool "Ethernet[3]"

    config TARGET_ETH3_NAME
        string "Ifname[3]"
        depends on TARGET_ETH3_LIST
endif

config TARGET_LAN_BRIDGE_NAME
    string "LAN bridge name"
    default "br-home"
    help
        LAN bridge name that will be used

menuconfig TARGET_LED_SUPPORT
    bool "Enable LED support"
    default n
    select TARGET_MANAGER_LEDM
    help
        Enable LED support (requires LEDM). This option implements the
        target_led_device_dir() and target_led_names() functions.

    if TARGET_LED_SUPPORT
        config TARGET_LED_PATH
            string "LED path pattern"
            default "/sys/class/leds/%s"
            help
                The pattern used to access a LED device.
                The %s will be replaced with the LED name (see below).

        config TARGET_LED0
            bool "LED[0]"

        config TARGET_LED0_NAME
            string "Name[0]"
            depends on TARGET_LED0

        config TARGET_LED1
            bool "LED[1]"

        config TARGET_LED1_NAME
            string "Name[1]"
            depends on TARGET_LED1

        config TARGET_LED2
            bool "LED[2]"

        config TARGET_LED2_NAME
            string "Name[2]"
            depends on TARGET_LED2

        config TARGET_LED3
            bool "LED[3]"

        config TARGET_LED3_NAME
            string "Name[3]"
            depends on TARGET_LED3
    endif

menu "Model/Serial Number/SKU ..."

config TARGET_MODEL_GET
    bool "Use TARGET_MODEL as the model name"
    default y

    help
        Implement the target_model_get() function.

        This returns the TARGET_MODEL as the model. TARGET_MODEL
        is a top-level configuration option.

config TARGET_SERIAL_FROM_MAC
    bool "Use network interface MAC for serial number"
    default y
    help
        This is a rather common case for devices that have no easy access
        to their serial number or for early development stages.

        This option implements the target_serial_get() function.

config TARGET_SERIAL_FROM_MAC_IFNAME
    string "Interface name"
    default "eth0"
    depends on TARGET_SERIAL_FROM_MAC
    help
        Interface name that will be used for calculating the serial
        number from the MAC address

config TARGET_FIXED_HWREV
    bool "Use a fixed HW revision number"
    default y
    help
        This implements the target_hw_revision_get() function and returns the
        string as defined by TARGET_FIXED_HWREV_STRING

config TARGET_FIXED_HWREV_STRING
    string "HW revision number"
    default "1"
    depends on TARGET_FIXED_HWREV

config TARGET_FIXED_SKU
    bool "Use a fixed SKU number"
    default y
    help
        This option implements the target_sku_get() function and returns the
        string as defined by TARGET_SKU_STRING.

config TARGET_SKU_STRING
    string "SKU number"
    default "SKU123456"
    depends on TARGET_FIXED_SKU
endmenu

menu "Upgrade, OTA ..."
config TARGET_UPGRADE_SAFEUPDATE
    bool "Device supports safeupdate upgrades"
    help
        Enable if the device supports upgrades via safeupdate

        This implements the following functions:
            - target_upg_command()
            - target_upg_command_full()
            - target_upg_command_args()
            - target_upg_download_required()

config TARGET_UPGRADE_NO_PRECHECK
    bool "No extra pre-upgrade checks are required"
    depends on TARGET_UPGRADE_SAFEUPDATE
    default y

    help
        This option provides a dummy target_upg_download_required()
        function which always returns true.

config TARGET_FREE_SPACE_REPORTING
    bool "Free space reporting"
    default y
    depends on TARGET_MANAGER_UM
    help
        Define Warning/Error thresholds for free space on /tmp during
        upgrade image download.

config TARGET_FREE_SPACE_ERROR
    int "Free space error (in KB) on /tmp"
    default 16384
    depends on TARGET_FREE_SPACE_REPORTING
    help
        UM will refuse to download an upgrade image if free space is below this thershold
        on /tmp.

config TARGET_FREE_SPACE_WARNING
    int "Free space warning (in KB)"
    default 19456
    depends on TARGET_FREE_SPACE_REPORTING
    help
        A warning will be displayhed when an upgrade is attempted and free space on /tmp
        is below this value.

endmenu

menu "Misc..."
config TARGET_RESTART_SCRIPT
    bool "Use a script to restart managers"
    default y
    help
        Use a script to execute a manager restart

config TARGET_RESTART_SCRIPT_CMD
    string "Command to execute"
    default "$(PLUME_BIN)/restart.sh"
    depends on TARGET_RESTART_SCRIPT

config TARGET_LINUX_LOGPULL
    bool "Device supports standard logpull"
    default y
    help
        Device has the lm_logs_collector.sh script
        which can be used for generating log pulls.

        This option implements the target_log_pull() function.


config TARGET_WATCHDOG
    bool "Device has a watchdog"
    help
        If the device has a watchdog, select this option
        and implement the target_device_wdt_ping() function.

        This function will be periodically called to pet the watchdog.

config TARGET_LINUX_EXECUTE
    bool "Use generic Linux execute"
    default y
    help
        This implements the target_device_execute() function using the standard
        Linux system() call.

        You may want to select Y here for most linux-based SDKs.

config TARGET_CM_LINUX_SUPPORT_PACKAGE
    bool "CM Linux support package"
    default y

    help
        Various collection of functions that are mostly common for
        all Linux platforms.

        Required by CM2.

endmenu
```

## upstream/opensync/src/cm2/kconfig/Kconfig
```kconfig
config PLUME_CM2_DISABLE_DRYRUN_ON_GRE
    bool "Disable udhcpc dryrun on gre interfaces"
    default n
    help
        Skip running dryrun on gre interfaces.

config PLUME_CM2_USE_NOT_CUSTOM_UDHCPC
    bool "Use orginal udhcpc not custom by Plume"
    default n
    help
        Option when platforms can not modify udhcpc

config OPENSYNC_CM2_MTU_ON_GRE
    int "MTU on GRE interface"
    default 1500
    help
        Define mtu on gre interface for WiFi sta interfaces
```

## upstream/opensync/src/lib/evx/kconfig/Kconfig
```kconfig
config LIBEVX_USE_CARES
    bool "Asnychronous DNS resolution support"
    default n
    help
        Enable support for asynchronous DNS resolution.

        This requires libcares to be present on the platform.
```
