## upstream/opensync/src/lib/inet/kconfig/Kconfig
```kconfig
config INET_ETH_LINUX
    bool "Linux Ethernet interfaces"
    default y
    help
        Select to include generic Linux ethernet interface support.

        Applicable to most Linux platforms. If not selected, the
        platform/device specific code should provide its own implementation.

        This option implements the inet_eth_t class.

config INET_VIF_LINUX
    bool "Linux VIF interfaces"
    depends on INET_ETH_LINUX
    default y
    help
        Select to include generic Linux VIF interface support.

        Applicable to most Linux platforms. If not selected, the
        platform/device specific code should provide its own implementation.

        This option implements the inet_vif_t class.

config INET_GRETAP
    bool "Linux GRETAP interfaces"
    depends on INET_ETH_LINUX
    default y
    help
        Select to include generic Linux GRETAP interface support.

        Applicable to most Linux platforms. If not selected, the
        platform/device specific code should provide its own implementation.

        This option implements the inet_gretap_t class.

config INET_GRE_USE_GRETAP
    bool "Use GRETAP as default GRE protocol implementation"
    depends on INET_GRETAP
    default y
    help
        Use the inet_gretap_t class as the default GRE implementation.
        This option defines a inet_gre_new() function which instantiates
        a class of type inet_gretap_t. If not selected, the platform/device
        specific code should define inet_gre_new() function which returns a
        suitable interface object that implements a tunneling protocol.

config INET_VLAN_LINUX
    bool "Linux VLAN interfaces"
    depends on INET_ETH_LINUX
    default y
    help
        Select to include generic Linux VLAN interface support.

        Applicable to most Linux platforms. If not selected, the
        platform/device specific code should provide its own implementation.

        This option implements the inet_vlan_t class.

menu "Interface Status Reporting"

    choice
        prompt "Interface Status Detection"
        default INET_STATUS_POLL

            config INET_STATUS_POLL
                bool "Polling"
                help
                    Detect interface status changes by periodic polling.

                    This is the slowest, but most portable method.

            config INET_STATUS_NETLINK_POLL
                bool "Netlink Polling"
                help
                    Detect interface status changes by listening to NETLINK events.

                    This still polls the interface, except the poll trigger is a NETLINK event
                    instead of a timer.

                    This is somewhat faster than polling, but not as portable.
    endchoice

    if INET_STATUS_POLL
        config INET_STATUS_POLL_INTERVAL_MS
            int "Polling interval in milliseconds"
            default 200
            help
                The polling interval in milliseconds.
    endif
    if INET_STATUS_NETLINK_POLL
        config INET_STATUS_NETLINK_DEBOUNCE_MS
            int "Netlink event debounce interval"
            default 100
            help
                Since netlink events may occur in bursts and we're polling all interface
                variables in any case, we can debounce the netlink events for a slight
                performance boost at the cost of a slight delay in status updates.
    endif
endmenu


menuconfig INET_FW_ENABLED
    bool "Firewall"
    default y
    help
        Use Firewall implementation provided by INET. Available modules are: Null, Iptables

        This option implements the inet_fw_t class.

    if INET_FW_ENABLED
        comment "INET firewall configuration"
        choice
            prompt "Firewall implementation"
            default INET_FW_NULL

            config INET_FW_NULL
                bool "Null"
                help
                    Use the dummy firewall implementation. Use this on platforms
                    that do not have firewall functionality or firewall is not
                    under Plume control.

            config INET_FW_IPTABLES
                bool "iptables"
                help
                    Use the generic Linux iptables firewall implementation.
        endchoice

        if INET_FW_IPTABLES
            comment "INET iptables configuration"
            config INET_FW_IPTABLES_PATH
                string '"iptables" binary path'
                default "/usr/sbin/iptables"
                help
                    Full path to the iptables binary

            config INET_FW_IP6TABLES_PATH
                string '"ip6tables" binary path'
                default "/usr/sbin/ip6tables"
                help
                    Full path to the ip6tables binary
        endif
    endif

menuconfig INET_DNS_ENABLED
    bool "DNS resolver"
    default y
    help
        Use DNS resolver implementation provided by INET.

        This option implements the inet_dns_t class.

    if INET_DNS_ENABLED
        comment "INET DNS resolver configuration"
        choice
            prompt "DNS resolver implementation"
            default INET_DNS_NULL

            config INET_DNS_NULL
                bool "Null"
                help
                    Dummy DNS resolver implementation. Use this on platforms that do not
                    support configuration of the DNS resolver or it is not managed by Plume

            config INET_DNS_RESOLVCONF
                bool "resolv.conf"
                help
                    Use "resolv.conf" for DNS resolver configuration. Supported by most Linux
                    platforms.
        endchoice

        if INET_DNS_RESOLVCONF
            comment "INET resolv.conf configuration"
            config INET_RESOLVCONF_PATH
                string 'Path to the "resolv.conf" file'
                default "/tmp/resolv.conf"
                help
                    Path to the "resolv.conf" file. On embedded systems this is typically
                    somewhere on /tmp

            config INET_RESOLVCONF_TMP
                string "Path to the temporary DNS folders"
                default "/tmp/dns"
                help
                    This path is used to store intermediate DNS files. Each interface
                    creates one such file (in resolv.conf format). The final "resolv.conf"
                    file is aggregated from all intermediate files.
        endif
    endif

menuconfig INET_DHSNIFF_ENABLED
    bool "DHCP sniffing"
    default y
    help
        Use DHCP sniffing implementation as provided by LIBINET

        This option implements the inet_dhsniff_t class.

    if INET_DHSNIFF_ENABLED
        comment "INET DHCP sniffing configuration"
        choice
            prompt "DHCP sniffing implementation"
            default INET_DHSNIFF_NULL

            config INET_DHSNIFF_NULL
                bool "Null"
                help
                    Dummy DHCP sniffing implementation. Use this on platforms that do not
                    support DHCP sniffing.

            config INET_DHSNIFF_PCAP
                bool "Packet capture (libpcap)"
                help
                    Use a libpcap based DHCP sniffing implementation. Applicable to most
                    Linux platformns.
        endchoice

        if INET_DHSNIFF_PCAP
            config DHSNIFF_PCAP_IMMEDIATE
                bool "Use immediate mode"
                default y
                help
                    This option enables PCAP "immediate" mode. Apparently this instructs
                    PCAP to deliver packets as fast as possible instead of buffering.

            config DHSNIFF_PCAP_PROMISC
                bool "Use promiscuous mode"
                help
                    This option enables the calling of pcap_set_promisc() to enable
                    promiscuous mode.

                    If unsure, select 'n'.

            config DHSNIFF_PCAP_BUFFER_SIZE
                int "Set libpcap buffer size"
                default 0
                help
                    By default libpcap uses a buffer size of 2MB or more. On systems
                    with low memory you may want to set this to something reasonably small.
                    The buffer size must be greater than the current snapshot length (plus some overhead).

                    If unsure, use 0 (use libpcap default).

            config DHSNIFF_PCAP_SNAPLEN
                int "Set snapshot len"
                default 0
                help
                    Set a custom snapshot length.

                    If unsure, use 0 (use libpcap default - 65535).
        endif
    endif

menuconfig INET_IGMP_SNOOPING_ENABLED
    bool "IGMP snooping"
    default y
    help
        Use IGMP snooping enabling/disabling implementation as provided by LIBINET.

        This option implements the inet_igmp_t class.

    if INET_IGMP_SNOOPING_ENABLED
        comment "INET IGMP snooping configuration"
        choice
            prompt "IGMP snooping implementation"
            default INET_IGMP_NULL

            config INET_IGMP_NULL
                bool "Null"
                help
                    Dummy igmp snooping implementation. Use this on platforms that do not
                    support igmp snooping.

            config INET_IGMP_SNOOPING
                bool "Linux igmp snooping implementation"
                help
                    Use Wifi_Inet_Config table to enable or disable igmp snooping on device.
        endchoice
    endif
```

## upstream/opensync/src/lib/osn/kconfig/Kconfig
```kconfig
menuconfig OSN_DHCPS_DNSMASQ
    bool "DHCP Server: Dnsmasq"
    default y
    help
        OpenSync DHCPv4 server implementation using dnsmasq.

        This option implements the osn_dhcp_server_t API using dnsmasq.

    if OSN_DHCPS_DNSMASQ
        comment "Dnsmasq configuration"

        config OSN_DNSMASQ_PATH
            string "Path to the dnsmasq binary"
            default "/usr/sbin/dnsmasq"
            help
                Full path to the dnsmasq binary

        config OSN_DNSMASQ_ETC_PATH
            string "dnsmasq configuration file path"
            default "/var/etc/dnsmasq.conf"
            help
                This is the path where the dnsmasq configuration file
                will be generated.

        config OSN_DNSMASQ_LEASE_PATH
            string "Location of the DHCP lease file"
            default "/tmp/dhcp.leases"
            help
                Location of the "leases" file. This is the dnsmasq
                DHCP lease database.

        config OSN_DNSMASQ_PID_PATH
            string "Location of the dnsmasq PID file"
            default "/var/run/dnsmasq/dnsmasq.pid"
            help
                Location of the dnsmasq PID file.

        config OSN_DNSMASQ_KEEP_RUNNING
            bool 'Daemon should be always running'
            help
                The default behavior is to kill dnsmasq as soon as there are
                0 DHCP server configurations active. This option forces dnsmasq
                to be active regardless of the DHCP server configuration.

                This is useful on systems where dnsmasq is used as a DNS cache.
    endif


menuconfig OSN_DHCPC_UDHCPC
    bool "DHCP client: udhcpc"
    default y
    help
        OpenSync DHCPv4 client implementation using busybox's udhcpc as backend.

        This option implements the osn_dhcp_client_t class.

    if OSN_DHCPC_UDHCPC
        comment "udhcpc configuration"
        config OSN_UDHCPC_PATH
            string "Path to the udhcpc binary"
            default "/sbin/udhcpc"
            help
                Full path to the udhcpc binary.
    endif

menuconfig OSN_UPNP_MINIUPNPD
    bool "UPnP server: miniupnpd"
    default y
    help
        Use UPnP server implementation provided by INET.

    if OSN_UPNP_MINIUPNPD
        comment "miniupnpd configuration"

        config OSN_MINIUPNPD_PATH
            string "Path to the miniupnpd binary"
            default "/usr/sbin/miniupnpd"
            help
                Full path to the miniupnpd binary

        config OSN_MINIUPNPD_ETC
            string "miniupnpd configuration folder"
            default "/tmp/miniupnpd"
            help
                This is the location where the miniupnpd.conf and upnpd.lease
                files will be created.
    endif

menuconfig OSN_ROUTE_LINUX
    bool "Routing table"
    default y
    help
        Route notification using Linux interfaces:
            - /proc/net/route
            - NETLINK socketrs

        This option implements the osn_route_t class.

config OSN_NETLINK_DEBOUNCE_MS
    int "Netlink event debouncing interval"
    default 300
    help
        Delay processing of netlink events for this amount in milliseconds.

        Netlink events may come in bursts. Delaying and aggregating them may
        yield some performance boost.
```
