// SPDX-License-Identifier: (GPL-2.0+ OR BSD-3-Clause)
/*
 * IPQ5424 RDP466-rffe board device tree source
 *
 * Copyright (c) 2024 Qualcomm Innovation Center, Inc. All rights reserved.
 */

#include <arm64/qcom/ipq5424-rdp466-rffe.dts>
