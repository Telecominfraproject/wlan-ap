// SPDX-License-Identifier: (GPL-2.0+ OR BSD-3-Clause)
/*
 * IPQ9574 RDP461-C21 board device tree source
 *
 * Copyright (c) 2022-2024 Qualcomm Innovation Center, Inc. All rights reserved.
 */

#include <arm64/qcom/ipq9574-rdp461-c21.dts>

/ {
	chosen {
		stdout-path = "serial0";
		bootargs-append = " vmalloc=1G";
	};
};
