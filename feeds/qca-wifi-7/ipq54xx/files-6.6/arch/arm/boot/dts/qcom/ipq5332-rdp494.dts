// SPDX-License-Identifier: (GPL-2.0+ OR BSD-3-Clause)
/*
 * IPQ5332 RDP494 board device tree source
 *
 * Copyright (c) 2020 The Linux Foundation. All rights reserved.
 * Copyright (c) Qualcomm Technologies, Inc. and/or its subsidiaries.
 */

#include <arm64/qcom/ipq5332-rdp494.dts>

/ {
	chosen {
		stdout-path = "serial0";
		bootargs-append = " vmalloc=1G";
	};
};
