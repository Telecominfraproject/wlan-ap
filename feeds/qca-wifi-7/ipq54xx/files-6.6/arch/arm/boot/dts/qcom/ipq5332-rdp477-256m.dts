// SPDX-License-Identifier: (GPL-2.0+ OR BSD-3-Clause)
/*
 * IPQ5332 RDP477-256m board device tree source
 *
 * Copyright (c) 2020 The Linux Foundation. All rights reserved.
 * Copyright (c) 2022-2024 Qualcomm Innovation Center, Inc. All rights reserved.
 */

#include <arm64/qcom/ipq5332-rdp477-256m.dts>

/ {
	chosen {
		stdout-path = "serial0";
		bootargs-append = " vmalloc=1G";
	};
};
