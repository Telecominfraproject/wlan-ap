// SPDX-License-Identifier: (GPL-2.0+ OR BSD-3-Clause)
/*
 * IPQ9574 RDP433-mht-switch board device tree source
 *
 * Copyright (c) 2020-2021 The Linux Foundation. All rights reserved.
 * Copyright (c) 2022-2023 Qualcomm Innovation Center, Inc. All rights reserved.
 */

#include <arm64/qcom/ipq9574-rdp433-mht-switch.dts>

/ {
	chosen {
		stdout-path = "serial0";
		bootargs-append = " vmalloc=1G";
	};
};
