// SPDX-License-Identifier: (GPL-2.0+ OR BSD-3-Clause)
/*
 * IPQ9574 RDP 433 sfp board device tree source
 *
 * Copyright (c) 2022, 2025 Qualcomm Innovation Center, Inc. All rights reserved.
 */

#include <arm64/qcom/ipq9574-rdp433-sfp.dts>
