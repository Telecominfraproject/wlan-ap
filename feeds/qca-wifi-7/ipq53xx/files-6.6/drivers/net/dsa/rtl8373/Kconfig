## feeds/qca-wifi-7/ipq53xx/files-6.6/drivers/net/dsa/rtl8373/Kconfig
```kconfig
## SPDX-License-Identifier: GPL-2.0-only
menuconfig NET_DSA_REALTEK_RTL8373
	tristate "Realtek Ethernet rtl8373 switch family support"
	depends on NET_DSA
	select FIXED_PHY
	select IRQ_DOMAIN
	select REGMAP
	select NET_DSA_TAG_QCA
	help
	  Select to enable support for Realtek Ethernet switch chips.

	  Note that at least one interface driver must be enabled for the
	  subdrivers to be loaded. Moreover, an interface driver cannot achieve
	  anything without at least one subdriver enabled.

if NET_DSA_REALTEK_RTL8373
config NET_DSA_REALTEK_RTL8373_SMI
	tristate "Realtek RTL8373 switch driver"
	depends on NET_DSA
	help
	  Select to enable support for Realtek RTL8373.

config NET_DSA_REALTEK_RTL8373_PHY
    bool "Realtek RTL8373 PHY core"
    default y

config NET_DSA_REALTEK_RTL8373_I2C
	tristate "RTL8373 ethernet switch in I2C managed mode"
	depends on NET_DSA && I2C
	select REGMAP_I2C
	help
	  Enable access functions if the RTL8373 I2C is configured
	  for I2C managed mode.

config NET_DSA_REALTEK_RTL8373_EXTPHY
	tristate "Realtek RTL8373 switch external PHY support"
	depends on NET_DSA
	help
	  Select to enable external PHY if RTL8373 switch SerDes1 have connect to external PHY chip.

config NET_DSA_REALTEK_RTL8373_EXTPHYAD
	int "Realtek RTL8373 switch external PHY address"
	depends on NET_DSA_REALTEK_RTL8373_EXTPHY
	range 0 31
	default 0
	help
	  Setting external PHY address.
endif
```
