## feeds/qca-wifi-7/ipq53xx/files-6.6/drivers/net/dsa/rtl8373/Kconfig
```kconfig
# SPDX-License-Identifier: GPL-2.0-only
menuconfig NET_DSA_REALTEK_RTL8373
	tristate "Realtek Ethernet rtl8373 switch family support"
	depends on NET_DSA
	select FIXED_PHY
	select IRQ_DOMAIN
	select REGMAP
	select NET_DSA_TAG_QCA
	help
	  Select to enable support for Realtek Ethernet switch chips.

	  Note that at least one interface driver must be enabled for the
	  subdrivers to be loaded. Moreover, an interface driver cannot achieve
	  anything without at least one subdriver enabled.

if NET_DSA_REALTEK_RTL8373
config NET_DSA_REALTEK_RTL8373_SMI
	tristate "Realtek RTL8373 switch driver"
	depends on NET_DSA
	help
	  Select to enable support for the Realtek RTL8373 family of
	  multi-gigabit Ethernet switches (RTL8373, RTL8372, RTL8366U).
	  The switch is managed by the host SoC over an MDC/MDIO (SMI)
	  interface and is registered with the kernel as a DSA switch,
	  so each front-panel port appears as its own network interface.

	  If unsure, say N.

config NET_DSA_REALTEK_RTL8373_PHY
	bool "Realtek RTL8373 PHY core"
	default y
	help
	  Enable the PHY access layer of the RTL8373 driver. It provides
	  Clause 22 and Clause 45 register access to the internal PHYs
	  of the switch, which the driver uses for link configuration,
	  EEE and port status reporting.

	  If unsure, say Y.

config NET_DSA_REALTEK_RTL8373_I2C
	tristate "RTL8373 ethernet switch in I2C managed mode"
	depends on NET_DSA && I2C
	select REGMAP_I2C
	help
	  Enable the I2C interface driver for the RTL8373 switch. Select
	  this when the switch is strapped for I2C managed mode and the
	  host SoC accesses the switch registers over an I2C bus instead
	  of MDC/MDIO. The device is matched through the device tree
	  compatible string "realtek,rtl8373-i2c".

config NET_DSA_REALTEK_RTL8373_EXTPHY
	tristate "Realtek RTL8373 switch external PHY support"
	depends on NET_DSA
	help
	  Enable support for an external PHY chip connected to SerDes1 of
	  the RTL8373 switch. Select this only if the board design uses
	  an external PHY on that SerDes, and set its MDIO address with
	  NET_DSA_REALTEK_RTL8373_EXTPHYAD.

	  If unsure, say N.

config NET_DSA_REALTEK_RTL8373_EXTPHYAD
	int "Realtek RTL8373 switch external PHY address"
	depends on NET_DSA_REALTEK_RTL8373_EXTPHY
	range 0 31
	default 0
	help
	  MDIO address (0-31) of the external PHY connected to SerDes1
	  of the RTL8373 switch.
endif
```
