/*
 * Copyright (c) 2022 MediaTek Inc.
 * Author: Author: Xiufeng Li <Xiufeng.Li@mediatek.com>
 *
 * This program is free software; you can redistribute it and/or modify
 * it under the terms of the GNU General Public License version 2 as
 * published by the Free Software Foundation.
 *
 * This program is distributed in the hope that it will be useful,
 * but WITHOUT ANY WARRANTY; without even the implied warranty of
 * MERCHANTABILITY or FITNESS FOR A PARTICULAR PURPOSE.  See the
 * GNU General Public License for more details.
 */

&clkitg {
	status = "disabled";
	bring-up {
		compatible = "mediatek,clk-bring-up";
		clocks =
			<&apmixedsys CK_APMIXED_NETSYSPLL>,
			<&apmixedsys CK_APMIXED_MPLL>,
			<&apmixedsys CK_APMIXED_MMPLL>,
			<&apmixedsys CK_APMIXED_APLL2>,
			<&apmixedsys CK_APMIXED_NET1PLL>,
			<&apmixedsys CK_APMIXED_NET2PLL>,
			<&apmixedsys CK_APMIXED_WEDMCUPLL>,
			<&apmixedsys CK_APMIXED_SGMPLL>,
			<&apmixedsys CK_APMIXED_ARM_B>,
			<&apmixedsys CK_APMIXED_CCIPLL2_B>,
			<&apmixedsys CK_APMIXED_USXGMIIPLL>,
			<&apmixedsys CK_APMIXED_MSDCPLL>,
			<&topckgen CK_TOP_CB_CKSQ_40M>,
			<&topckgen CK_TOP_CB_M_416M>,
			<&topckgen CK_TOP_CB_M_D2>,
			<&topckgen CK_TOP_M_D3_D2>,
			<&topckgen CK_TOP_CB_M_D4>,
			<&topckgen CK_TOP_CB_M_D8>,
			<&topckgen CK_TOP_M_D8_D2>,
			<&topckgen CK_TOP_CB_MM_720M>,
			<&topckgen CK_TOP_CB_MM_D2>,
			<&topckgen CK_TOP_CB_MM_D3_D5>,
			<&topckgen CK_TOP_CB_MM_D4>,
			<&topckgen CK_TOP_MM_D6_D2>,
			<&topckgen CK_TOP_CB_MM_D8>,
			<&topckgen CK_TOP_CB_APLL2_196M>,
			<&topckgen CK_TOP_CB_APLL2_D4>,
			<&system_clk>,
			<&topckgen CK_TOP_CB_NET1_D5>,
			<&topckgen CK_TOP_NET1_D5_D2>,
			<&topckgen CK_TOP_NET1_D5_D4>,
			<&topckgen CK_TOP_CB_NET1_D8>,
			<&topckgen CK_TOP_NET1_D8_D2>,
			<&system_clk>,
			<&topckgen CK_TOP_NET1_D8_D8>,
			<&topckgen CK_TOP_NET1_D8_D16>,
			<&system_clk>,
			<&topckgen CK_TOP_CB_NET2_D2>,
			<&topckgen CK_TOP_CB_NET2_D4>,
			<&topckgen CK_TOP_NET2_D4_D4>,
			<&topckgen CK_TOP_NET2_D4_D8>,
			<&topckgen CK_TOP_CB_NET2_D6>,
			<&topckgen CK_TOP_CB_NET2_D8>,
			<&topckgen CK_TOP_CB_WEDMCU_208M>,
			<&system_clk>,
			<&topckgen CK_TOP_CB_NETSYS_850M>,
			<&topckgen CK_TOP_CB_MSDC_400M>,
			<&topckgen CK_TOP_CKSQ_40M_D2>,
			<&topckgen CK_TOP_CB_RTC_32K>,
			<&topckgen CK_TOP_CB_RTC_32P7K>,
			<&topckgen CK_TOP_INFRA_F32K>,
			<&topckgen CK_TOP_CKSQ_SRC>,
			<&system_clk>,
			<&system_clk>,
			<&system_clk>,
			<&topckgen CK_TOP_EIP197>,
			<&topckgen CK_TOP_EMMC_250M>,
			<&topckgen CK_TOP_EMMC_400M>,
			<&topckgen CK_TOP_SPI>,
			<&topckgen CK_TOP_SPIM_MST>,
			<&system_clk>,
			<&system_clk>,
			<&system_clk>,
			<&topckgen CK_TOP_USB_SYS>,
			<&topckgen CK_TOP_USB_SYS_P1>,
			<&topckgen CK_TOP_USB_XHCI>,
			<&topckgen CK_TOP_USB_XHCI_P1>,
			<&topckgen CK_TOP_USB_FRMCNT>,
			<&topckgen CK_TOP_USB_FRMCNT_P1>,
			<&topckgen CK_TOP_AUD>,
			<&topckgen CK_TOP_A1SYS>,
			<&topckgen CK_TOP_AUD_L>,
			<&topckgen CK_TOP_A_TUNER>,
			<&topckgen CK_TOP_SYSAXI>,
			<&topckgen CK_TOP_INFRA_F26M>,
			<&topckgen CK_TOP_USB_REF>,
			<&topckgen CK_TOP_USB_CK_P1>,
			<&system_clk>,
			<&system_clk>,
			<&system_clk>,
			<&system_clk>,
			<&system_clk>,
			<&system_clk>,
			<&system_clk>,
			<&system_clk>,
			<&topckgen CK_TOP_EIP197_SEL>,
			<&topckgen CK_TOP_AXI_INFRA_SEL>,
			<&system_clk>,
			<&topckgen CK_TOP_EMMC_250M_SEL>,
			<&topckgen CK_TOP_EMMC_400M_SEL>,
			<&topckgen CK_TOP_SPI_SEL>,
			<&topckgen CK_TOP_SPIM_MST_SEL>,
			<&system_clk>,
			<&system_clk>,
			<&system_clk>,
			<&system_clk>,
			<&topckgen CK_TOP_PCIE_MBIST_250M_SEL>,
			<&system_clk>,
			<&system_clk>,
			<&system_clk>,
			<&system_clk>,
			<&topckgen CK_TOP_USB_SYS_SEL>,
			<&topckgen CK_TOP_USB_SYS_P1_SEL>,
			<&topckgen CK_TOP_USB_XHCI_SEL>,
			<&topckgen CK_TOP_USB_XHCI_P1_SEL>,
			<&topckgen CK_TOP_USB_FRMCNT_SEL>,
			<&topckgen CK_TOP_USB_FRMCNT_P1_SEL>,
			<&system_clk>,
			<&system_clk>,
			<&system_clk>,
			<&system_clk>,
			<&topckgen CK_TOP_SSPXTP_SEL>,
			<&topckgen CK_TOP_USB_PHY_SEL>,
			<&system_clk>,
			<&system_clk>,
			<&system_clk>,
			<&topckgen CK_TOP_SGM_SBUS_0_SEL>,
			<&system_clk>,
			<&topckgen CK_TOP_SGM_SBUS_1_SEL>,
			<&system_clk>,
			<&system_clk>,
			<&topckgen CK_TOP_SYSAXI_SEL>,
			<&topckgen CK_TOP_SYSAPB_SEL>,
			<&system_clk>,
			<&system_clk>,
			<&system_clk>,
			<&system_clk>,
			<&topckgen CK_TOP_DRAMC_SEL>,
			<&topckgen CK_TOP_DRAMC_MD32_SEL>,
			<&topckgen CK_TOP_INFRA_F26M_SEL>,
			<&system_clk>,
			<&system_clk>,
			<&system_clk>,
			<&system_clk>,
			<&topckgen CK_TOP_DA_XTP_GLB_P0_SEL>,
			<&topckgen CK_TOP_DA_XTP_GLB_P1_SEL>,
			<&topckgen CK_TOP_DA_XTP_GLB_P2_SEL>,
			<&topckgen CK_TOP_DA_XTP_GLB_P3_SEL>,
			<&topckgen CK_TOP_CKM_SEL>,
			<&topckgen CK_TOP_DA_SELM_XTAL_SEL>,
			<&topckgen CK_TOP_PEXTP_SEL>,
			<&topckgen CK_TOP_MCUSYS_BACKUP_625M_SEL>,
			<&system_clk>,
			<&system_clk>,
			<&system_clk>,
			<&system_clk>,
			<&system_clk>,
			<&infracfg CK_INFRA_CK_F26M>,
			<&system_clk>,
			<&system_clk>,
			<&system_clk>,
			<&system_clk>,
			<&system_clk>,
			<&system_clk>,
			<&infracfg CK_INFRA_133M_PHCK>,
			<&system_clk>,
			<&infracfg CK_INFRA_FAUD_L_O>,
			<&infracfg CK_INFRA_FAUD_AUD_O>,
			<&infracfg CK_INFRA_FAUD_EG2_O>,
			<&system_clk>,
			<&system_clk>,
			<&system_clk>,
			<&system_clk>,
			<&system_clk>,
			<&system_clk>,
			<&infracfg CK_INFRA_SPI0_O>,
			<&infracfg CK_INFRA_SPI1_O>,
			<&infracfg CK_INFRA_LB_MUX_FRTC>,
			<&infracfg CK_INFRA_FRTC>,
			<&infracfg CK_INFRA_FMSDC400_O>,
			<&infracfg CK_INFRA_FMSDC2_HCK_OCC>,
			<&infracfg CK_INFRA_PERI_133M>,
			<&infracfg CK_INFRA_USB_O>,
			<&infracfg CK_INFRA_USB_O_P1>,
			<&infracfg CK_INFRA_USB_FRMCNT_O>,
			<&infracfg CK_INFRA_USB_FRMCNT_O_P1>,
			<&infracfg CK_INFRA_USB_XHCI_O>,
			<&infracfg CK_INFRA_USB_XHCI_O_P1>,
			<&infracfg CK_INFRA_USB_PIPE_O>,
			<&infracfg CK_INFRA_USB_PIPE_O_P1>,
			<&infracfg CK_INFRA_USB_UTMI_O>,
			<&infracfg CK_INFRA_USB_UTMI_O_P1>,
			<&system_clk>,
			<&system_clk>,
			<&system_clk>,
			<&system_clk>,
			<&infracfg CK_INFRA_F26M_O0>,
			<&infracfg CK_INFRA_F26M_O1>,
			<&system_clk>,
			<&system_clk>,
			<&infracfg CK_INFRA_PERI_66M_O>,
			<&infracfg CK_INFRA_USB_SYS_O>,
			<&infracfg CK_INFRA_USB_SYS_O_P1>,
			<&infracfg_ao CK_INFRA_66M_GPT_BCK>,
			<&system_clk>,
			<&system_clk>,
			<&system_clk>,
			<&system_clk>,
			<&system_clk>,
			<&system_clk>,
			<&system_clk>,
			<&system_clk>,
			<&system_clk>,
			<&system_clk>,
			<&infracfg_ao CK_INFRA_133M_CQDMA_BCK>,
			<&system_clk>,
			<&system_clk>,
			<&system_clk>,
			<&system_clk>,
			<&system_clk>,
			<&infracfg_ao CK_INFRA_DRAMC_F26M>,
			<&infracfg_ao CK_INFRA_133M_DBG_ACKM>,
			<&system_clk>,
			<&infracfg_ao CK_INFRA_66M_SEJ_BCK>,
			<&infracfg_ao CK_INFRA_PRE_CK_SEJ_F13M>,
			<&system_clk>,
			<&system_clk>,
			<&system_clk>,
			<&system_clk>,
			<&system_clk>,
			<&system_clk>,
			<&system_clk>,
			<&infracfg_ao CK_INFRA_66M_NFI_HCK>,
			<&infracfg_ao CK_INFRA_104M_SPI0>,
			<&infracfg_ao CK_INFRA_104M_SPI1>,
			<&infracfg_ao CK_INFRA_104M_SPI2_BCK>,
			<&infracfg_ao CK_INFRA_66M_SPI0_HCK>,
			<&infracfg_ao CK_INFRA_66M_SPI1_HCK>,
			<&infracfg_ao CK_INFRA_66M_SPI2_HCK>,
			<&infracfg_ao CK_INFRA_66M_FLASHIF_AXI>,
			<&infracfg_ao CK_INFRA_RTC>,
			<&infracfg_ao CK_INFRA_26M_ADC_BCK>,
			<&infracfg_ao CK_INFRA_RC_ADC>,
			<&system_clk>,
			<&system_clk>,
			<&system_clk>,
			<&system_clk>,
			<&infracfg_ao CK_INFRA_133M_CPUM_BCK>,
			<&infracfg_ao CK_INFRA_BIST2FPC>,
			<&system_clk>,
			<&system_clk>,
			<&system_clk>,
			<&system_clk>,
			<&system_clk>,
			<&system_clk>,
			<&system_clk>,
			<&system_clk>,
			<&system_clk>,
			<&system_clk>,
			<&infracfg_ao CK_INFRA_USB_FRMCNT>,
			<&infracfg_ao CK_INFRA_USB_FRMCNT_CK_P1>,
			<&system_clk>,
			<&system_clk>,
			<&system_clk>,
			<&system_clk>,
			<&system_clk>,
			<&system_clk>,
			<&system_clk>,
			<&system_clk>,
			<&system_clk>,
			<&system_clk>,
			<&system_clk>,
			<&system_clk>,
			<&system_clk>,
			<&system_clk>,
			<&system_clk>,
			<&system_clk>,
			<&system_clk>,
			<&system_clk>,
			<&system_clk>,
			<&system_clk>,
			<&system_clk>,
			<&system_clk>,
			<&system_clk>,
			<&system_clk>,
			<&system_clk>,
			<&infracfg_ao CK_INFRA_MUX_SPI0_SEL>,
			<&infracfg_ao CK_INFRA_MUX_SPI1_SEL>,
			<&infracfg_ao CK_INFRA_MUX_SPI2_SEL>,
			<&system_clk>,
			<&system_clk>,
			<&system_clk>,
			<&system_clk>,
			<&system_clk>,
			<&system_clk>,
			<&system_clk>,
			<&system_clk>,
			<&system_clk>,
			<&system_clk>,
			<&system_clk>,
			<&system_clk>,
			<&system_clk>,
			<&system_clk>,
			<&system_clk>,
			<&system_clk>,
			<&system_clk>,
			<&system_clk>,
			<&system_clk>,
			<&system_clk>,
			<&system_clk>,
			<&system_clk>,
			<&system_clk>,
			<&system_clk>,
			<&system_clk>,
			<&system_clk>,
			<&system_clk>,
			<&system_clk>,
			<&system_clk>,
			<&system_clk>,
			<&system_clk>;

		clock-names = "0", "1", "2", "3", "4", "5", "6", "7", "8", "9",
			      "10", "11", "12", "13", "14", "15", "16", "17",
			      "18", "19", "20", "21", "22", "23", "24", "25",
			      "26", "27", "28", "29", "30", "31", "32", "33",
			      "34", "35", "36", "37", "38", "39", "40", "41",
			      "42", "43", "44", "45", "46", "47", "48", "49",
			      "50", "51", "52", "53", "54", "55", "56", "57",
			      "58", "59", "60", "61", "62", "63", "64", "65",
			      "66", "67", "68", "69", "70", "71", "72", "73",
			      "74", "75", "76", "77", "78", "79", "80", "81",
			      "82", "83", "84", "85", "86", "87", "88", "89",
			      "90", "91", "92", "93", "94", "95", "96", "97",
			      "98", "99", "100", "101", "102", "103", "104",
			      "105", "106", "107", "108", "109", "110", "111",
			      "112", "113", "114", "115", "116", "117", "118",
			      "119", "120", "121", "122", "123", "124", "125",
			      "126", "127", "128", "129", "130", "131", "132",
			      "133", "134", "135", "136", "137", "138", "139",
			      "140", "141", "142", "143", "144", "145", "146",
			      "147", "148", "149", "150", "151", "152", "153",
			      "154", "155", "156", "157", "158", "159", "160",
			      "161", "162", "163", "164", "165", "166", "167",
			      "168", "169", "170", "171", "172", "173", "174",
			      "175", "176", "177", "178", "179", "180", "181",
			      "182", "183", "184", "185", "186", "187", "188",
			      "189", "190", "191", "192", "193", "194", "195",
			      "196", "197", "198", "199", "200", "201", "202",
			      "203", "204", "205", "206", "207", "208", "209",
			      "210", "211", "212", "213", "214", "215", "216",
			      "217", "218", "219", "220", "221", "222", "223",
			      "224", "225", "226", "227", "228", "229", "230",
			      "231", "232", "233", "234", "235", "236", "237",
			      "238", "239", "240", "241", "242", "243", "244",
			      "245", "246", "247", "248", "249", "250", "251",
			      "252", "253", "254", "255", "256", "257", "258",
			      "259", "260", "261", "262", "263", "264", "265",
			      "266", "267", "268", "269", "270", "271", "272",
			      "273", "274", "275", "276", "277", "278", "279",
			      "280", "281", "282", "283", "284", "285", "286",
			      "287", "288", "289", "290", "291", "292", "293",
			      "294", "295", "296", "297", "298", "299", "300",
			      "301", "302", "303", "304", "305", "306", "307",
			      "308", "309", "310", "311", "312", "313", "314",
			      "315", "316", "317", "318", "319", "320", "321",
			      "322", "323";
	};
};

