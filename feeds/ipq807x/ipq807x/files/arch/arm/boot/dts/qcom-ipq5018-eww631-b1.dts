#include "../../../arm64/boot/dts/qcom/qcom-ipq5018-eww631-b1.dts"

/ {
	model = "CyberTan EWW631-B1";
	compatible = "cybertan,eww631-b1", "qcom,ipq5018";

	pmuv8: pmu {
	compatible = "arm,cortex-a7-pmu";
	};
};
