#include "../../../arm64/boot/dts/qcom/qcom-ipq5018-eww631-a1.dts"

/ {
	model = "CyberTan EWW631-A1";
	compatible = "cybertan,eww631-a1", "qcom,ipq5018";

	pmuv8: pmu {
	compatible = "arm,cortex-a7-pmu";
	};
};
