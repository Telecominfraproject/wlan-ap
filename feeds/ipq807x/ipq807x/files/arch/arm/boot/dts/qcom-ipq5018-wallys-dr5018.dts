#include "../../../arm64/boot/dts/qcom/qcom-ipq5018-wallys-dr5018.dts"

/ {
	model = "Wallys DR5018";
	compatible = "wallys,dr5018", "qcom,ipq5018";

	pmuv8: pmu {
	compatible = "arm,cortex-a7-pmu";
	};
};
