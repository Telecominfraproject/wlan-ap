## feeds/qca-wifi-7/mac80211/wlan-open-extns/ath/ath12k/src/Kconfig
```kconfig
config QCN_EXTN
	bool "Enable QCN extensions support"
	depends on ATH12K
	default y
	help
	  Select this option to enable QCN 802.11 extensions in ath12k
	  drivers that support it..
```

## feeds/qca/hostapd/Config.in
```kconfig
# wpa_supplicant config
config WPA_RFKILL_SUPPORT
	bool "Add rfkill support"
	depends on PACKAGE_wpa-supplicant-qca || \
		   PACKAGE_wpa-supplicant-qca-openssl || \
		   PACKAGE_wpa-supplicant-qca-wolfssl || \
		   PACKAGE_wpa-supplicant-qca-mbedtls || \
		   PACKAGE_wpa-supplicant-qca-mesh-openssl || \
		   PACKAGE_wpa-supplicant-qca-mesh-wolfssl || \
		   PACKAGE_wpa-supplicant-qca-mesh-mbedtls || \
		   PACKAGE_wpa-supplicant-qca-basic || \
		   PACKAGE_wpa-supplicant-qca-mini || \
		   PACKAGE_wpa-supplicant-qca-p2p || \
		   PACKAGE_wpad-qca || \
		   PACKAGE_wpad-qca-openssl || \
		   PACKAGE_wpad-qca-wolfssl || \
		   PACKAGE_wpad-qca-mbedtls || \
		   PACKAGE_wpad-qca-basic || \
		   PACKAGE_wpad-qca-basic-openssl || \
		   PACKAGE_wpad-qca-basic-wolfssl || \
		   PACKAGE_wpad-qca-basic-mbedtls || \
		   PACKAGE_wpad-qca-mini || \
		   PACKAGE_wpad-qca-mesh-openssl || \
		   PACKAGE_wpad-qca-mesh-wolfssl || \
		   PACKAGE_wpad-qca-mesh-mbedtls
	default n

config WPA_MSG_MIN_PRIORITY
	int "Minimum debug message priority"
	depends on PACKAGE_wpa-supplicant-qca || \
		   PACKAGE_wpa-supplicant-qca-openssl || \
		   PACKAGE_wpa-supplicant-qca-wolfssl || \
		   PACKAGE_wpa-supplicant-qca-mbedtls || \
		   PACKAGE_wpa-supplicant-qca-mesh-openssl || \
		   PACKAGE_wpa-supplicant-qca-mesh-wolfssl || \
		   PACKAGE_wpa-supplicant-qca-mesh-mbedtls || \
		   PACKAGE_wpa-supplicant-qca-basic || \
		   PACKAGE_wpa-supplicant-qca-mini || \
		   PACKAGE_wpa-supplicant-qca-p2p || \
		   PACKAGE_wpad-qca || \
		   PACKAGE_wpad-qca-openssl || \
		   PACKAGE_wpad-qca-wolfssl || \
		   PACKAGE_wpad-qca-mbedtls || \
		   PACKAGE_wpad-qca-basic || \
		   PACKAGE_wpad-qca-basic-openssl || \
		   PACKAGE_wpad-qca-basic-wolfssl || \
		   PACKAGE_wpad-qca-basic-mbedtls || \
		   PACKAGE_wpad-qca-mini || \
		   PACKAGE_wpad-qca-mesh-openssl || \
		   PACKAGE_wpad-qca-mesh-wolfssl || \
		   PACKAGE_wpad-qca-mesh-mbedtls
	default 3
	help
	  Useful values are:
	    0 = all messages
		1 = raw message dumps
		2 = most debugging messages
		3 = info messages
		4 = warnings
		5 = errors

config WPA_WOLFSSL
	bool
	default PACKAGE_wpa-supplicant-qca-wolfssl ||\
	        PACKAGE_wpad-qca-wolfssl ||\
	        PACKAGE_wpad-qca-basic-wolfssl || \
	        PACKAGE_wpad-qca-mesh-wolfssl ||\
	        PACKAGE_eapol-test-qca-wolfssl
	select WOLFSSL_HAS_AES_CCM
	select WOLFSSL_HAS_ARC4
	select WOLFSSL_HAS_DH
	select WOLFSSL_HAS_OCSP
	select WOLFSSL_HAS_SESSION_TICKET
	select WOLFSSL_HAS_WPAS

config DRIVER_WEXT_SUPPORT
	bool
	select KERNEL_WIRELESS_EXT
	default n

config DRIVER_11AC_SUPPORT
	bool
	default n

config DRIVER_11AX_SUPPORT
	bool
	default n
	select WPA_MBO_SUPPORT

config WPA_ENABLE_WEP
	bool "Enable support for unsecure and obsolete WEP"
	help
	  Wired equivalent privacy (WEP) is an obsolete cryptographic data
	  confidentiality algorithm that is not considered secure. It should not be used
	  for anything anymore. The functionality needed to use WEP is available in the
	  current hostapd release under this optional build parameter and completely
	  removed in a future release.

config WPA_MBO_SUPPORT
	bool "Multi Band Operation (Agile Multiband)"
	default PACKAGE_wpa-supplicant-qca || \
		PACKAGE_wpa-supplicant-qca-openssl || \
		PACKAGE_wpa-supplicant-qca-wolfssl || \
		PACKAGE_wpa-supplicant-qca-mbedtls || \
		PACKAGE_wpad-qca || \
		PACKAGE_wpad-qca-openssl || \
		PACKAGE_wpad-qca-wolfssl || \
		PACKAGE_wpad-qca-mbedtls
	help
	  Multi Band Operation aka (Agile Multiband) enables features
	  that facilitate efficient use of multiple frequency bands.
	  Enabling MBO on an AP using RSN requires 802.11w to be enabled.
	  Hostapd will refuse to start if MBO and RSN are enabled without 11w.
```

## feeds/wlan-ap-consumer/opensync/Config.in
```kconfig
menu "Opensync configuration"
	depends on PACKAGE_opensync

config OPENSYNC_PLATFORM
	string "OpenSync platform"
	default openwrt
	help
		openwrt - TIP default
		cfg80211 - CFG80211 target layer support

config OPENSYNC_TARGET
	string "OpenSync vendor target"
	default TIP
	help
		Valid targets are:
		TIP - Using vendor/tip and platform/openwrt (TIP default)
		GENERIC_CFG80211 - Using vendor/plume-openwrt and platform/cfg80211

config OPENSYNC_SERVICE_PROVIDER
	string "OpenSync service provider"
	default opensync-dev
	help
		opensync-dev - service provider for development

config OPENSYNC_DEPLOYMENT_PROFILE
	string "OpenSync service provider profile"
	default opensync-dev
	help
		opensync-dev - development profile

endmenu
```

## feeds/wlan-ap/opensync/src/platform/openwrt/kconfig/Kconfig.managers
```kconfig
comment "Platform Managers"
rsource "../src/rrm/kconfig/Kconfig.managers"
rsource "../src/netifd/kconfig/Kconfig.managers"
```

## feeds/wlan-ap/opensync/src/platform/openwrt/src/netifd/kconfig/Kconfig.managers
```kconfig
menuconfig MANAGER_NM_NETIFD
    bool "Network Manager (NM NETIFD)"
    default n
    help
        Enable Network Manager (NM NETIFD)

    config MANAGER_NM_NETIFD_CFG
        depends on MANAGER_NM_NETIFD
        string "NM NETIFD Startup configuration"
        default "nm;true;needs_plan_b=true"
        help
            Network Manager (NETIFD) startup configuration
```

## feeds/wlan-ap/opensync/src/platform/openwrt/src/rrm/kconfig/Kconfig.managers
```kconfig
menuconfig MANAGER_RRM
    bool "RRM"
    default y 
    help
        Enable Radio Resource Manager

        ovsh u Node_Services --where service==rrm enable:=true

    config MANAGER_RRM_CFG
        string "Radio Resource Manager configuration"
        depends on MANAGER_RRM
        default "rrm;true"
        help
            RRM startup configuration
```
