## feeds/morse/utils/hostapd_s1g/Config.in
```kconfig
if PACKAGE_hostapd_s1g

	config MORSE_HOSTAPD_S1G_EAP
		bool
		default n
		prompt "Enable Extensible Authentication Protocol (EAP) support"

	config MORSE_HOSTAPD_S1G_ACS
		bool
		default n
		prompt "Enable automatic channel selection (ACS) support"
		help
			This will allow hostapd to pick the channel automatically when channel is set
			to "acs_survey" or "0". Eventually, other ACS algorithms can be added in
			similar way.

endif
```

## feeds/morse/utils/wpa_supplicant_s1g/Config.in
```kconfig
if PACKAGE_wpa_supplicant_s1g

	config MORSE_WPA_SUPPLICANT_S1G_MESH_NETWORKING
		bool
		default n
		prompt "Enable mesh networking support"

	config MORSE_WPA_SUPPLICANT_S1G_EAP
		bool
		default n
		prompt "Enable Extensible Authentication Protocol (EAP) support"

endif
```

## feeds/mtk-app/tops-tool/Config.in
```kconfig
menu "TOPS Tool Configurations"
	depends on PACKAGE_tops-tool

config MTK_TOPS_TOOL_SAVE_LOG
	bool "Save Log"
	depends on MTK_TOPS_LOGGER
	default y
	help
	  Set y to enable tops-tool logging feature to save
	  TOPS firmware log to file system for further
	  debugging purpose.
	  Use command echo ON to start collecting log and
	  echo OFF to stop collecting log.
endmenu
```

## feeds/mtk-wifi-7/crypto-eip/Config.in
```kconfig
menu "Crypto Offload Configuration"
	depends on PACKAGE_kmod-crypto-eip

choice
	prompt "Crypto Offload Mode"
	default CRYPTO_OFFLOAD_INLINE
	help
	  Select crypto offload mode. Support lookaside mode or inline mode.

config CRYPTO_OFFLOAD_INLINE
	bool "Inline Mode"
	depends on TARGET_mediatek_mt7988 || TARGET_DEVICE_mediatek_filogic_DEVICE_mediatek_mt7988a-rfb || TARGET_DEVICE_mediatek_filogic_DEVICE_mediatek_mt7988d-rfb
	select PACKAGE_kmod-crypto-eip-inline
	select PACKAGE_kmod-crypto-eip-ddk
	select PACKAGE_kmod-crypto-eip-ddk-ksupport
	select PACKAGE_kmod-crypto-eip-ddk-ctrl
	select PACKAGE_kmod-crypto-eip-ddk-ctrl-app
	select PACKAGE_kmod-crypto-eip-ddk-engine
	select PACKAGE_crypto-eip-inline-fw
	select PACKAGE_strongswan
	select PACKAGE_strongswan-mod-kdf
	select PACKAGE_strongswan-default
endchoice

choice
	prompt "Crypto XFRM Offload Method"
	depends on CRYPTO_OFFLOAD_INLINE
	default CRYPTO_XFRM_OFFLOAD_MTK_PCE
	help
	  Select crypto XFRM offload method. Either RAMBUS PCL support or
	  MTK PCE support.

config CRYPTO_XFRM_OFFLOAD_MTK_PCE
	bool "Enable MTK PCE XFRM Offload"
endchoice

endmenu
```

## feeds/mtk-wifi-7/crypto-eip/src/Kconfig
```kconfig
config MTK_CRYPTO_EIP_INLINE
	tristate "Mediatek Crypto EIP Inline"
	help
	  Support for Mediatek driver to control inline crypto HW offload
	  engine EIP197. The HW offload engine support IPsec ESP inline
	  offload. Currently, it only support ESP Tunnel and transport mode.
	  The driver cooperate XFRM offload framework with Mediatek HNAT
	  driver to offload ESP protocol.
```

## feeds/qca-wifi-7/ipq53xx/files-6.6/Documentation/devicetree/bindings/leds/ti,lp5812.yaml
```yaml
# SPDX-License-Identifier: (GPL-2.0-only OR BSD-2-Clause)
%YAML 1.2
---
$id: http://devicetree.org/schemas/leds/ti,lp5812.yaml#
$schema: http://devicetree.org/meta-schemas/core.yaml#

title: TI LP5812 4×3 Matrix RGB LED Driver with Autonomous Control

maintainers:
  - Nam Tran <trannamatk@gmail.com>

description: |
  The LP5812 is a 4×3 matrix RGB LED driver with I2C interface
  and autonomous animation engine control.
  For more product information please see the link below:
  https://www.ti.com/product/LP5812#tech-docs

properties:
  compatible:
    const: ti,lp5812

  reg:
    maxItems: 1

  vcc-supply:
    description: Regulator providing power to the 'VCC' pin.

  '#address-cells':
    const: 1

  '#size-cells':
    const: 0

patternProperties:
  "^led@[0-3]$":
    type: object
    $ref: common.yaml#
    unevaluatedProperties: false

    properties:
      led-cur:
        $ref: /schemas/types.yaml#/definitions/uint8
        description: |
          LED current in 0.1 mA steps (e.g., 150 = 15.0 mA; 0 if not connected)
        minimum: 0
        maximum: 255

      max-cur:
        $ref: /schemas/types.yaml#/definitions/uint8
        description: Maximum allowed current in 0.1 mA steps

      reg:
        minimum: 0
        maximum: 3

  '^multi-led@[4-7]$':
    type: object
    $ref: leds-class-multicolor.yaml#
    unevaluatedProperties: false

    properties:
      reg:
        minimum: 4
        maximum: 7

      '#address-cells':
        const: 1

      '#size-cells':
        const: 0

    patternProperties:
      "^led@[4-9a-f]$":
        type: object
        $ref: common.yaml#
        unevaluatedProperties: false

        properties:
          led-cur:
            $ref: /schemas/types.yaml#/definitions/uint8
            description: |
              LED current in 0.1 mA steps (e.g., 150 = 15.0 mA; 0 if not connected)
            minimum: 0
            maximum: 255

          max-cur:
            $ref: /schemas/types.yaml#/definitions/uint8
            description: Maximum allowed current in 0.1 mA steps

          reg:
            minimum: 4
            maximum: 15

        required:
          - reg

required:
  - compatible
  - reg

additionalProperties: false

examples:
  - |
    #include <dt-bindings/leds/common.h>

    i2c {
        #address-cells = <1>;
        #size-cells = <0>;

        led-controller@1b {
            #address-cells = <1>;
            #size-cells = <0>;
            compatible = "ti,lp5812";
            reg = <0x1b>;
            vcc-supply = <&vdd_3v3_reg>;

            led@0 {
              reg = <0x0>;
              label = "LED0";
              led-cur = /bits/ 8 <0x96>;
              max-cur = /bits/ 8 <0xff>;
            };

            led@1 {
              reg = <0x1>;
              label = "LED1";
              led-cur = /bits/ 8 <0x96>;
              max-cur = /bits/ 8 <0xff>;
            };

            led@2 {
              reg = <0x2>;
              label = "LED2";
              led-cur = /bits/ 8 <0x96>;
              max-cur = /bits/ 8 <0xff>;
            };

            led@3 {
              reg = <0x3>;
              label = "LED3";
              led-cur = /bits/ 8 <0x96>;
              max-cur = /bits/ 8 <0xff>;
            };

            multi-led@4 {
              #address-cells = <1>;
              #size-cells = <0>;
              reg = <0x4>;
              color = <LED_COLOR_ID_RGB>;
              label = "LED_A";

              led@4 {
                reg = <0x4>;
                color = <LED_COLOR_ID_GREEN>;
                led-cur = /bits/ 8 <0x96>;
                max-cur = /bits/ 8 <0xff>;
              };

              led@5 {
                reg = <0x5>;
                color = <LED_COLOR_ID_RED>;
                led-cur = /bits/ 8 <0x96>;
                max-cur = /bits/ 8 <0xff>;
              };

              led@6 {
                reg = <0x6>;
                color = <LED_COLOR_ID_BLUE>;
                led-cur = /bits/ 8 <0x96>;
                max-cur = /bits/ 8 <0xff>;
              };
            };

            multi-led@5 {
              #address-cells = <1>;
              #size-cells = <0>;
              reg = <0x5>;
              color = <LED_COLOR_ID_RGB>;
              label = "LED_B";

              led@7 {
                reg = <0x7>;
                color = <LED_COLOR_ID_GREEN>;
                led-cur = /bits/ 8 <0x96>;
                max-cur = /bits/ 8 <0xff>;
              };

              led@8 {
                reg = <0x8>;
                color = <LED_COLOR_ID_RED>;
                led-cur = /bits/ 8 <0x96>;
                max-cur = /bits/ 8 <0xff>;
              };

              led@9 {
                reg = <0x9>;
                color = <LED_COLOR_ID_BLUE>;
                led-cur = /bits/ 8 <0x96>;
                max-cur = /bits/ 8 <0xff>;
              };
            };

            multi-led@6 {
              #address-cells = <1>;
              #size-cells = <0>;
              reg = <0x6>;
              color = <LED_COLOR_ID_RGB>;
              label = "LED_C";

              led@a {
                reg = <0xa>;
                color = <LED_COLOR_ID_GREEN>;
                led-cur = /bits/ 8 <0x96>;
                max-cur = /bits/ 8 <0xff>;
              };

              led@b {
                reg = <0xb>;
                color = <LED_COLOR_ID_RED>;
                led-cur = /bits/ 8 <0x96>;
                max-cur = /bits/ 8 <0xff>;
              };

              led@c {
                reg = <0xc>;
                color = <LED_COLOR_ID_BLUE>;
                led-cur = /bits/ 8 <0x96>;
                max-cur = /bits/ 8 <0xff>;
              };
            };

            multi-led@7 {
              #address-cells = <1>;
              #size-cells = <0>;
              reg = <0x7>;
              color = <LED_COLOR_ID_RGB>;
              label = "LED_D";

              led@d {
                reg = <0xd>;
                color = <LED_COLOR_ID_GREEN>;
                led-cur = /bits/ 8 <0x96>;
                max-cur = /bits/ 8 <0xff>;
              };

              led@e {
                reg = <0xe>;
                color = <LED_COLOR_ID_RED>;
                led-cur = /bits/ 8 <0x96>;
                max-cur = /bits/ 8 <0xff>;
              };

              led@f {
                reg = <0xf>;
                color = <LED_COLOR_ID_BLUE>;
                led-cur = /bits/ 8 <0x96>;
                max-cur = /bits/ 8 <0xff>;
              };
            };
        };
    };

...
```
