## feeds/qca-wifi-7/mac80211/src/Kconfig.local
```kconfig
config BACKPORTED_BACKPORT_DIR
	tristate
	default BACKPORT_DIR
config BACKPORTED_BACKPORTS_VERSION
	tristate
	default BACKPORTS_VERSION
config BACKPORTED_BACKPORTED_KERNEL_VERSION
	tristate
	default BACKPORTED_KERNEL_VERSION
config BACKPORTED_BACKPORTED_KERNEL_NAME
	tristate
	default BACKPORTED_KERNEL_NAME
config BACKPORTED_WIRELESS
	tristate
	default WIRELESS
config BACKPORTED_NET_CORE
	tristate
	default NET_CORE
config BACKPORTED_EXPERT
	tristate
	default EXPERT
config BACKPORTED_BP_MODULES
	tristate
	default BP_MODULES
config BACKPORTED_BPAUTO_BUILD_NLATTR
	tristate
	default BPAUTO_BUILD_NLATTR
config BACKPORTED_BPAUTO_USERSEL_BUILD_ALL
	tristate
	default BPAUTO_USERSEL_BUILD_ALL
config BACKPORTED_BPAUTO_WANT_DEV_COREDUMP
	tristate
	default BPAUTO_WANT_DEV_COREDUMP
config BACKPORTED_BPAUTO_CRYPTO_LIB_ARC4
	tristate
	default BPAUTO_CRYPTO_LIB_ARC4
config BACKPORTED_BPAUTO_BUILD_CRYPTO_LIB_ARC4
	tristate
	default BPAUTO_BUILD_CRYPTO_LIB_ARC4
config BACKPORTED_WIRELESS_EXT
	tristate
	default WIRELESS_EXT
config BACKPORTED_WEXT_CORE
	tristate
	default WEXT_CORE
config BACKPORTED_WEXT_PROC
	tristate
	default WEXT_PROC
config BACKPORTED_WEXT_PRIV
	tristate
	default WEXT_PRIV
config BACKPORTED_CFG80211
	tristate
	default CFG80211
config BACKPORTED_NL80211_TESTMODE
	tristate
	default NL80211_TESTMODE
config BACKPORTED_CFG80211_DEVELOPER_WARNINGS
	tristate
	default CFG80211_DEVELOPER_WARNINGS
config BACKPORTED_CFG80211_CERTIFICATION_ONUS
	tristate
	default CFG80211_CERTIFICATION_ONUS
config BACKPORTED_CFG80211_REQUIRE_SIGNED_REGDB
	tristate
	default CFG80211_REQUIRE_SIGNED_REGDB
config BACKPORTED_CFG80211_USE_KERNEL_REGDB_KEYS
	tristate
	default CFG80211_USE_KERNEL_REGDB_KEYS
config BACKPORTED_CFG80211_EXTRA_REGDB_KEYDIR
	tristate
	default CFG80211_EXTRA_REGDB_KEYDIR
config BACKPORTED_CFG80211_REG_CELLULAR_HINTS
	tristate
	default CFG80211_REG_CELLULAR_HINTS
config BACKPORTED_CFG80211_REG_RELAX_NO_IR
	tristate
	default CFG80211_REG_RELAX_NO_IR
config BACKPORTED_CFG80211_DEFAULT_PS
	tristate
	default CFG80211_DEFAULT_PS
config BACKPORTED_CFG80211_DEBUGFS
	tristate
	default CFG80211_DEBUGFS
config BACKPORTED_CFG80211_CRDA_SUPPORT
	tristate
	default CFG80211_CRDA_SUPPORT
config BACKPORTED_CFG80211_WEXT
	tristate
	default CFG80211_WEXT
config BACKPORTED_CFG80211_KUNIT_TEST
	tristate
	default CFG80211_KUNIT_TEST
config BACKPORTED_MAC80211
	tristate
	default MAC80211
config BACKPORTED_MAC80211_HAS_RC
	tristate
	default MAC80211_HAS_RC
config BACKPORTED_MAC80211_RC_MINSTREL
	tristate
	default MAC80211_RC_MINSTREL
config BACKPORTED_MAC80211_RC_DEFAULT_MINSTREL
	tristate
	default MAC80211_RC_DEFAULT_MINSTREL
config BACKPORTED_MAC80211_RC_DEFAULT
	tristate
	default MAC80211_RC_DEFAULT
config BACKPORTED_MAC80211_KUNIT_TEST
	tristate
	default MAC80211_KUNIT_TEST
config BACKPORTED_MAC80211_MESH
	tristate
	default MAC80211_MESH
config BACKPORTED_MAC80211_LEDS
	tristate
	default MAC80211_LEDS
config BACKPORTED_MAC80211_DEBUGFS
	tristate
	default MAC80211_DEBUGFS
config BACKPORTED_MAC80211_MESSAGE_TRACING
	tristate
	default MAC80211_MESSAGE_TRACING
config BACKPORTED_MAC80211_DEBUG_MENU
	tristate
	default MAC80211_DEBUG_MENU
config BACKPORTED_MAC80211_NOINLINE
	tristate
	default MAC80211_NOINLINE
config BACKPORTED_MAC80211_VERBOSE_DEBUG
	tristate
	default MAC80211_VERBOSE_DEBUG
config BACKPORTED_MAC80211_MLME_DEBUG
	tristate
	default MAC80211_MLME_DEBUG
config BACKPORTED_MAC80211_STA_DEBUG
	tristate
	default MAC80211_STA_DEBUG
config BACKPORTED_MAC80211_HT_DEBUG
	tristate
	default MAC80211_HT_DEBUG
config BACKPORTED_MAC80211_OCB_DEBUG
	tristate
	default MAC80211_OCB_DEBUG
config BACKPORTED_MAC80211_IBSS_DEBUG
	tristate
	default MAC80211_IBSS_DEBUG
config BACKPORTED_MAC80211_PS_DEBUG
	tristate
	default MAC80211_PS_DEBUG
config BACKPORTED_MAC80211_MPL_DEBUG
	tristate
	default MAC80211_MPL_DEBUG
config BACKPORTED_MAC80211_MPATH_DEBUG
	tristate
	default MAC80211_MPATH_DEBUG
config BACKPORTED_MAC80211_MHWMP_DEBUG
	tristate
	default MAC80211_MHWMP_DEBUG
config BACKPORTED_MAC80211_MESH_SYNC_DEBUG
	tristate
	default MAC80211_MESH_SYNC_DEBUG
config BACKPORTED_MAC80211_MESH_CSA_DEBUG
	tristate
	default MAC80211_MESH_CSA_DEBUG
config BACKPORTED_MAC80211_MESH_PS_DEBUG
	tristate
	default MAC80211_MESH_PS_DEBUG
config BACKPORTED_MAC80211_TDLS_DEBUG
	tristate
	default MAC80211_TDLS_DEBUG
config BACKPORTED_MAC80211_DEBUG_COUNTERS
	tristate
	default MAC80211_DEBUG_COUNTERS
config BACKPORTED_MAC80211_STA_HASH_MAX_SIZE
	tristate
	default MAC80211_STA_HASH_MAX_SIZE
config BACKPORTED_WLAN
	tristate
	default WLAN
config BACKPORTED_ATH_COMMON
	tristate
	default ATH_COMMON
config BACKPORTED_WLAN_VENDOR_ATH
	tristate
	default WLAN_VENDOR_ATH
config BACKPORTED_ATH_DEBUG
	tristate
	default ATH_DEBUG
config BACKPORTED_ATH_TRACEPOINTS
	tristate
	default ATH_TRACEPOINTS
config BACKPORTED_ATH_REG_DYNAMIC_USER_REG_HINTS
	tristate
	default ATH_REG_DYNAMIC_USER_REG_HINTS
config BACKPORTED_ATH_REG_DYNAMIC_USER_CERT_TESTING
	tristate
	default ATH_REG_DYNAMIC_USER_CERT_TESTING
config BACKPORTED_WIL6210
	tristate
	default WIL6210
config BACKPORTED_WIL6210_ISR_COR
	tristate
	default WIL6210_ISR_COR
config BACKPORTED_WIL6210_TRACING
	tristate
	default WIL6210_TRACING
config BACKPORTED_WIL6210_DEBUGFS
	tristate
	default WIL6210_DEBUGFS
config BACKPORTED_ATH11K
	tristate
	default ATH11K
config BACKPORTED_ATH11K_AHB
	tristate
	default ATH11K_AHB
config BACKPORTED_ATH11K_PCI
	tristate
	default ATH11K_PCI
config BACKPORTED_ATH11K_DEBUG
	tristate
	default ATH11K_DEBUG
config BACKPORTED_ATH11K_DEBUGFS
	tristate
	default ATH11K_DEBUGFS
config BACKPORTED_ATH11K_TRACING
	tristate
	default ATH11K_TRACING
config BACKPORTED_ATH11K_SPECTRAL
	tristate
	default ATH11K_SPECTRAL
config BACKPORTED_ATH12K
	tristate
	default ATH12K
config BACKPORTED_ATH12K_DEBUG
	tristate
	default ATH12K_DEBUG
config BACKPORTED_ATH12K_DEBUGFS
	tristate
	default ATH12K_DEBUGFS
config BACKPORTED_ATH12K_TRACING
	tristate
	default ATH12K_TRACING
config BACKPORTED_ATH12K_COREDUMP
	tristate
	default ATH12K_COREDUMP
config BACKPORTED_MAC80211_HWSIM
	tristate
	default MAC80211_HWSIM
config BACKPORTED_VIRT_WIFI
	tristate
	default VIRT_WIFI
```

## feeds/qca-wifi-7/mac80211/src/compat/Kconfig
```kconfig
#
# backport Kconfig
#
# Some options are user-selectable ("BPAUTO_USERSEL_*")
#
# Most options, however, follow a few different schemes:
#
# A) An option that is selected by drivers ("select FOO") will be
#    changed to "select BPAUTO_FOO" (if the option BPAUTO_FOO
#    exists). The option BPAUTO_FOO then controls setting of the
#    BPAUTO_BUILD_FOO option, which is a module, like this:
#
# config BPAUTO_BUILD_FOO
#	tristate
#	# or bool
#
#	# not possible on kernel < X.Y, build will fail if any
#	# drivers are allowed to build on kernels < X.Y
#	depends on KERNEL_X_Y
#
#	# don't build the backport code if FOO is in the kernel
#	# already, but only if the kernel version is also >= X.Z;
#	# this is an example of backporting where the version of
#	# the FOO subsystem that we need is only available from
#	# kernel version X.Z
#	depends on !FOO || KERNEL_X_Z
#
#	# build if driver needs it (it selects BPAUTO_FOO)
#	default m if BPAUTO_FOO
#
#	# or for build-testing (BPAUTO_USERSEL_BUILD_ALL is enabled)
#	default m if BPAUTO_USERSEL_BUILD_ALL
#
# config BPAUTO_FOO
#	bool
#
# This only works as-is if the kernel code is usable on any version,
# otherwise the "&& !FOO" part needs to be different.
#
#
# B) An option for code always present on some kernels (e.g. KFIFO).
#    This simply depends on/sets the default based on the version:
#
# config BPAUTO_BUILD_KFIFO
#	def_bool y
#	depends on KERNEL_2_6_36
#
#
# C) similarly, a kconfig symbol for an option, e.g.
#    BPAUTO_OPTION_SOME_FIX (no examples provided) check git log
#
#
# Variations are obviously possible.
#

config BP_MODULES
	option modules
	bool
	default MODULES

	help
	This symbol is necessary for the newer kconf tool, it looks
	for the "option modules" to control the 'm' state.

config BPAUTO_BUILD_NLATTR
	def_bool y
	depends on KERNEL_5_2
	#c-file lib/nlattr.c

config BPAUTO_USERSEL_BUILD_ALL
	bool "Build all compat code"
	help
	  This option selects all the compat code options
	  that would otherwise only be selected by drivers.

	  It's only really useful for compat testing, so
	  you probably shouldn't enable it.

config BPAUTO_WANT_DEV_COREDUMP
	bool

config BPAUTO_CRYPTO_LIB_ARC4
	bool

config BPAUTO_BUILD_CRYPTO_LIB_ARC4
	bool
	default y if BPAUTO_CRYPTO_LIB_ARC4
	depends on !(CRYPTO_LIB_ARC4=y || CRYPTO_LIB_ARC4=m)
	#h-file crypto/arc4.h
	#c-file lib/crypto/arc4.c
```

## feeds/qca-wifi-7/mac80211/src/drivers/net/wireless/Kconfig
```kconfig
# SPDX-License-Identifier: GPL-2.0-only
#
# Wireless LAN device configuration
#

menuconfig WLAN
	bool "Wireless LAN"
	depends on !S390
	depends on NET
	select WIRELESS
	default y
	help
	  This section contains all the pre 802.11 and 802.11 wireless
	  device drivers. For a complete list of drivers and documentation
	  on them refer to the wireless wiki:

	  https://wireless.wiki.kernel.org/en/users/Drivers

if WLAN

source "drivers/net/wireless/ath/Kconfig"

source "drivers/net/wireless/virtual/Kconfig"

endif # WLAN
```

## feeds/qca-wifi-7/mac80211/src/drivers/net/wireless/ath/ath11k/Kconfig
```kconfig
# SPDX-License-Identifier: BSD-3-Clause-Clear
config ATH11K
	depends on !KERNEL_5_2
	tristate "Qualcomm Technologies 802.11ax chipset support"
	depends on m
	depends on MAC80211 && HAS_DMA
	depends on CRYPTO_MICHAEL_MIC
	select ATH_COMMON
	help
	  This module adds support for Qualcomm Technologies 802.11ax family of
	  chipsets.

	  If you choose to build a module, it'll be called ath11k.

config ATH11K_NSS_SUPPORT
	bool "QCA ath11k nss support"
	depends on ATH11K
	default n
	select MAC80211_NSS_SUPPORT
	---help---
	  Enables NSS offload support for ATH11K driver

	  If unsure, say Y to enable NSS offload support.

config ATH11K_AHB
	tristate "Atheros ath11k AHB support"
	depends on m
	depends on ATH11K
	depends on REMOTEPROC
	help
	  This module adds support for AHB bus

config ATH11K_PCI
	tristate "Atheros ath11k PCI support"
	depends on m
	depends on ATH11K && PCI
	depends on MHI_BUS
	depends on QRTR
	depends on QRTR_MHI
	select PCI_PWRCTL_PWRSEQ if HAVE_PWRCTL
	help
	  This module adds support for PCIE bus

config ATH11K_DEBUG
	bool "QCA ath11k debugging"
	depends on ATH11K
	help
	  Enables debug support

	  If unsure, say Y to make it easier to debug problems.

config ATH11K_DEBUGFS
	bool "QCA ath11k debugfs support"
	depends on ATH11K && DEBUG_FS && MAC80211_DEBUGFS
	help
	  Enable ath11k debugfs support

	  If unsure, say Y to make it easier to debug problems.

config ATH11K_TRACING
	bool "ath11k tracing support"
	depends on ATH11K && EVENT_TRACING
	help
	  Select this to use ath11k tracing infrastructure.

config ATH11K_SPECTRAL
	bool "QCA ath11k spectral scan support"
	depends on ATH11K_DEBUGFS
	depends on RELAY
	help
	  Enable ath11k spectral scan support

	  Say Y to enable access to the FFT/spectral data via debugfs.

config ATH11K_PKTLOG
	bool "ath11k packet logging support"
	depends on ATH11K_DEBUGFS
	help
	  Say Y to dump frame information during frame transmission
	  and reception, rate information and ani state. The packet
	  log uses ring buffer to dump the data. The buffer size,
	  frame filters can be alterted by debugfs entries.

config ATH11K_MEM_PROFILE_512M
	bool "ath11k enable 512MB memory profile"
	depends on ATH11K
	default n
	help
	  Enables 512MB memory profile for ath11k

config ATH11K_CFR
	bool "QCA ath11k CFR support"
	depends on ATH11K_DEBUGFS
	depends on RELAY
	help
	  Enable ath11k cfr dump support

	  Say Y to enable access to collect cfr data dump via debugfs.

config ATH11K_SMART_ANT_ALG
	bool "Smart antenna algorithm support"
	depends on ATH11K
	default y
	---help---
	This option enables smart antenna algorithm.
```

## feeds/qca-wifi-7/mac80211/src/drivers/net/wireless/ath/ath12k/Kconfig
```kconfig
# SPDX-License-Identifier: BSD-3-Clause-Clear
config BACKPORT_DIR
	string
	option env="BACKPORT_DIR"

config ATH12K
	tristate "Qualcomm Technologies Wi-Fi 7 support (ath12k)"
	depends on m
	depends on MAC80211 && HAS_DMA && PCI
	depends on CRYPTO_MICHAEL_MIC
	depends on QCOM_QMI_HELPERS
	depends on MHI_BUS
	depends on QRTR
	depends on QRTR_MHI
	select PCI_PWRCTL_PWRSEQ if HAVE_PWRCTL
	help
	  Enable support for Qualcomm Technologies Wi-Fi 7 (IEEE
	  802.11be) family of chipsets, for example WCN7850 and
	  QCN9274.

	  If you choose to build a module, it'll be called ath12k.

config ATH12K_SAWF
	bool "ath12k Service Aware WiFi Framework and Telemetry support"
	depends on ATH12K
	help
	  Enable ath12k SAWF and telemetry support
	  Say Y to enable. If unsure, say N.

config ATH12K_POWER_OPTIMIZATION
	bool "ath12k Power and Thermal Optimization support"
	depends on ATH12K
	help
	  Enable ath12k Power Reduction support
	  Say Y to enable. If unsure, say N.

config ATH12K_AHB
	bool "QTI ath12k AHB support"
	depends on ATH12K && REMOTEPROC && QCOM_Q6V5_WCSS_SEC
	help
	  Enable support for Ath12k AHB bus chipsets, example IPQ5332.

config ATH12K_DEBUG
	bool "ath12k debugging"
	depends on ATH12K
	help
	  Enable debug support, for example debug messages which must
	  be enabled separately using the debug_mask module parameter.

	  If unsure, say Y to make it easier to debug problems. But if
	  you want optimal performance choose N.

config ATH12K_DEBUGFS
	bool "QTI ath12k debugfs support"
	depends on ATH12K && MAC80211_DEBUGFS
	help
	  Enable ath12k debugfs support

	  If unsure, say Y to make it easier to debug problems. But if
	  you want optimal performance choose N.

config ATH12K_TRACING
	bool "ath12k tracing support"
	depends on ATH12K && EVENT_TRACING
	help
	  Enable ath12k tracing infrastructure.

	  If unsure, say Y to make it easier to debug problems. But if
	  you want optimal performance choose N.

config ATH12K_COREDUMP
	bool "ath12k coredump"
	depends on ATH12K
	select WANT_DEV_COREDUMP
	help
	  Enable ath12k coredump collection

	  If unsure, say Y to make it easier to debug problems. But if
	  dump collection not required choose N.

choice
	prompt "Memory profile"
	depends on ATH12K
	default ATH12K_MEM_PROFILE_DEFAULT
	help
	  Allows to select the memory profile

	  By enabling this option, can choose between different memory
	  profiles, such as the default profile or a 512 MB profile.

config ATH12K_MEM_PROFILE_DEFAULT
	bool "ath12k default memory profile"
	depends on ATH12K
	help
	  Enables the default memory profile

	  This profile is recommended when memory is not constraint or
	  if unsure which profile to choose.

config ATH12K_MEM_PROFILE_512M
	bool "ath12k enable 512MB memory profile"
	depends on ATH12K
	help
	  Enables the 512MB memory profile

	  Selecting this option reduces memory allocation to the firmware,
	  decreases the number of transmit and receive descriptors, and
	  limits the monitor ring and the number of virtual devices
	  (vdevs).

endchoice

config ATH12K_CFR
	bool "QCA ath12k CFR support"
	depends on ATH12K_DEBUGFS
	depends on RELAY
	help
	  Enable ath12k cfr dump support

	  Say Y to enable access to collect cfr data dump via debugfs.

config ATH12K_SPECTRAL
	bool "QTI ath12k spectral scan support"
	depends on ATH12K_DEBUGFS
	depends on RELAY
	help
	  Enable ath12k spectral scan support

	  Say Y to enable access to the FFT/spectral data via debugfs.

config ATH12K_PPE_DS_SUPPORT
	bool "QTI ath12k ppe-ds support"
	depends on ATH12K_DEBUGFS
	depends on RELAY
	help
		Enable ath12k PPE-DS support

		Say Y to enable PPE DS Support. If unsure, say N.

source "$BACKPORT_DIR/drivers/net/wireless/ath/ath12k/qcn_extns/Kconfig"

config ATHDEBUG
	bool "ath12k debugging module"
	depends on ATH12K
	help
	  Enable athdebug module support, this module will help to
	  enable various debugging feature such as debug mask, minidump,
	  QDSS.

	  If unsure, say Y to make it easier to debug problems.
```
