## feeds/qca-wifi-7/ipq54xx/files-6.6/Documentation/devicetree/bindings/net/wireless/qcom,ath12k.yaml
```yaml
# SPDX-License-Identifier: (GPL-2.0-only OR BSD-2-Clause)
# Copyright (c) 2024 Qualcomm Innovation Center, Inc. All rights reserved.
%YAML 1.2
---
$id: http://devicetree.org/schemas/net/wireless/qcom,ath12k.yaml#
$schema: http://devicetree.org/meta-schemas/core.yaml#

title: Qualcomm Technologies ath12k wireless devices (PCIe)

maintainers:
  - Jeff Johnson <quic_jjohnson@quicinc.com>
  - Kalle Valo <quic_kvalo@quicinc.com>

description:
  Qualcomm Technologies IEEE 802.11be PCIe devices.

properties:
  compatible:
    enum:
      - pci17cb,1107  # WCN7850
      - qcom,qcn9274-wifi

  reg:
    maxItems: 1

  qcom,wsi:
    $ref: /schemas/types.yaml#/definitions/phandle
    description:
      DT entry of WLAN Serial Interface.
      Phandle to a node that can contain the following properties
        * id: It represents MLO (Multi-Link Operation) group id
        * num_devices: Number of WiFi devices connected through WSI
        * chip_info: Chip index and adjacent related information based
                     on WSI order for all chipsets.
                     <chip_idx num_adj_chips adj_idx[0] adj_idx[1]>
                     For different chipsets, same adjacent chip id's should not
                     be in same index. For example, Let's consider three chipsets(0 1 2),
                     For chip_idx 1,adjacent chip id should be 2 0 as 2 is
                     immediate adjacent chip not 0 2.

  secure-reg:
    type: <prop-encoded-array>
    description:
      secure registers which need to be write with kernel IPC mechanisum
      * addr: secure address to write
      * value : value to write

required:
  - compatible
  - reg

additionalProperties: false

allOf:
  - if:
      properties:
        compatible:
          contains:
            enum:
              - pci17cb,1107

examples:
  - |
    #include <dt-bindings/clock/qcom,rpmh.h>
    #include <dt-bindings/gpio/gpio.h>
    pcie {
        #address-cells = <3>;
        #size-cells = <2>;

        pcie@0 {
            device_type = "pci";
            reg = <0x0 0x0 0x0 0x0 0x0>;
            #address-cells = <3>;
            #size-cells = <2>;
            ranges;

            bus-range = <0x01 0xff>;

            wifi@0 {
                compatible = "pci17cb,1107";
                reg = <0x10000 0x0 0x0 0x0 0x0>;
            };
        };
    };

  - |
    pcie {
        #address-cells = <3>;
        #size-cells = <2>;

        pcie@0 {
            reg = <0x0 0x0 0x0 0x0 0x0>;
            #address-cells = <3>;
            #size-cells = <2>;

            wifi@0 {
                compatible = "qcom,qcn9274-wifi";
                reg = <0x0 0x0 0x0 0x0 0x0>;

                qcom,wsi = <&wsi>;
                qcom,wsi_index = <0>;
            };
        };
    };
```

## feeds/qca-wifi-7/ipq54xx/files-6.6/Documentation/devicetree/bindings/phy/qcom,m31.yaml
```yaml
# SPDX-License-Identifier: ISC

%YAML 1.2
---
$id: http://devicetree.org/schemas/phy/qcom,m31.yaml#
$schema: http://devicetree.org/meta-schemas/core.yaml#

title: QTI M31 USB PHY

maintainers:
  - Sricharan Ramabadhran <quic_srichara@quicinc.com>
  - Varadarajan Narayanan <quic_varada@quicinc.org>

description:
  This file contains documentation for the USB M31 PHY found in QTI
  IPQ5018, IPQ5332 SoCs.

properties:
  compatible:
    oneOf:
      - items:
          - enum:
              - qcom,m31-usb-hsphy
              - qcom,ipq5332-m31-usb-hsphy

  reg:
    description:
      Offset and length of the M31 PHY register set
    maxItems: 2

  reg-names:
    items:
      - const: m31usb_phy_base
      - const: qscratch_base

  phy_type:
    oneOf:
      - items:
          - enum:
              - utmi
              - ulpi

  resets:
    maxItems: 1
    description:
      List of phandles and reset pairs, one for each entry in reset-names.

  reset-names:
    items:
      - const:
          usb2_phy_reset

additionalProperties: false

examples:
  - |
    #include <dt-bindings/clock/qcom,ipq5332-gcc.h>
    hs_m31phy_0: hs_m31phy@5b00 {
        compatible = "qcom,m31-usb-hsphy";
        reg = <0x5b000 0x3000>,
            <0x08af8800 0x400>;
        reg-names = "m31usb_phy_base",
                "qscratch_base";
        phy_type = "utmi";
        resets = <&gcc GCC_QUSB2_0_PHY_BCR>;
        reset-names = "usb2_phy_reset";

        status = "ok";
    };
```

## feeds/qca-wifi-7/ipq54xx/files-6.6/Documentation/devicetree/bindings/remoteproc/qcom,multipd-pil.yaml
```yaml
# SPDX-License-Identifier: (GPL-2.0-only OR BSD-3-Clause)
%YAML 1.2
---
$id: http://devicetree.org/schemas/remoteproc/qcom,multipd-pil.yaml#
$schema: http://devicetree.org/meta-schemas/core.yaml#

title: QTI Multipd Secure Peripheral Image Loader

maintainers:
  - Bjorn Andersson <andersson@kernel.org>
  - Mathieu Poirier <mathieu.poirier@linaro.org>

description:
  Multipd Peripheral Image Loader loads firmware and boots Q6 pd, WCSS pd
  remoteproc's on the QTI IPQ5018, IPQ9574 SoC.

properties:
  compatible:
    enum:
      - qcom,ipq5018-q6-mpd
      - qcom,ipq9574-q6-mpd

  '#address-cells': true

  '#size-cells': true

  'ranges': true

  reg:
    maxItems: 1

  interrupts-extended:
    items:
      - description: Watchdog interrupt
      - description: Fatal interrupt
      - description: Ready interrupt
      - description: Handover interrupt
      - description: Stop acknowledge interrupt

  interrupt-names:
    items:
      - const: wdog
      - const: fatal
      - const: ready
      - const: handover
      - const: stop-ack

  clocks:
    minItems: 25
    maxItems: 25

  clock-names:
    minItems: 25
    maxItems: 25

  assigned-clocks:
    minItems: 13
    maxItems: 13

  assigned-clock-rates:
    minItems: 13
    maxItems: 13

  qcom,smem-states:
    $ref: /schemas/types.yaml#/definitions/phandle-array
    description: States used by the AP to signal the remoteprocessor
    items:
      - description: Shutdown Q6
      - description: Stop Q6

  qcom,smem-state-names:
    description:
      Names of the states used by the AP to signal the remoteprocessor
    items:
      - const: shutdown
      - const: stop

  memory-region:
    items:
      - description: Q6 pd reserved region

  glink-edge:
    $ref: /schemas/remoteproc/qcom,glink-edge.yaml#
    description:
      Qualcomm G-Link subnode which represents communication edge, channels
      and devices related to the Modem.

patternProperties:
  "^remoteproc_pd1|remoteproc_pd2|remoteproc_pd3":
    type: object
    description:
      In Multipd model, WCSS pd depends on Q6 pd i.e Q6 pd should be up before
      WCSS. It can be achieved by keeping wcss pd node as subnode of Q6
      device node.

    properties:
      compatible:
        enum:
          - "qcom,ipq5018-wcss-ahb-mpd"
          - "qcom,ipq9574-wcss-ahb-mpd"
          - "qcom,ipq5018-wcss-pcie-mpd"

      interrupts-extended:
        items:
          - description: Fatal interrupt
          - description: Ready interrupt
          - description: Spawn acknowledge interrupt
          - description: Stop acknowledge interrupt

      interrupt-names:
        items:
          - const: fatal
          - const: ready
          - const: spawn-ack
          - const: stop-ack

      qcom,smem-states:
        $ref: /schemas/types.yaml#/definitions/phandle-array
        description: States used by the AP to signal the remoteprocessor
        items:
          - description: Shutdown WCSS pd
          - description: Stop WCSS pd
          - description: Spawn WCSS pd

      qcom,smem-state-names:
        description:
          Names of the states used by the AP to signal the remoteprocessor
        items:
          - const: shutdown
          - const: stop
          - const: spawn

    required:
      - compatible

    additionalProperties: false

required:
  - compatible
  - reg
  - interrupts-extended
  - interrupt-names
  - qcom,smem-states
  - qcom,smem-state-names
  - memory-region

additionalProperties: false

allOf:
  - if:
      properties:
        compatible:
          enum:
            - qcom,ipq9574-q6-mpd
    then:
      properties:
        assigned-clocks:
          items:
            - description: Phandle, clock specifier of GCC_ANOC_WCSS_AXI_M_CLK
            - description: Phandle, clock specifier of GCC_WCSS_AHB_S_CLK
            - description: Phandle, clock specifier of GCC_WCSS_ECAHB_CLK
            - description: Phandle, clock specifier of GCC_WCSS_ACMT_CLK
            - description: Phandle, clock specifier of GCC_WCSS_AXI_M_CLK
            - description: Phandle, clock specifier of GCC_Q6_AXIM_CLK
            - description: Phandle, clock specifier of GCC_Q6_AXIM2_CLK
            - description: Phandle, clock specifier of GCC_Q6_AHB_CLK
            - description: Phandle, clock specifier of GCC_Q6_AHB_S_CLK
            - description: Phandle, clock specifier of GCC_Q6SS_BOOT_CLK
            - description: Phandle, clock specifier of GCC_MEM_NOC_Q6_AXI_CLK
            - description: Phandle, clock specifier of GCC_WCSS_Q6_TBU_CLK
            - description: Phandle, clock specifier of GCC_SYS_NOC_WCSS_AHB_CLK
        assigned-clock-rates:
          items:
            - description: Must be 266666667 HZ
            - description: Must be 133333333 HZ
            - description: Must be 133333333 HZ
            - description: Must be 133333333 HZ
            - description: Must be 266666667 HZ
            - description: Must be 533000000 HZ
            - description: Must be 342857143 HZ
            - description: Must be 133333333 HZ
            - description: Must be 133333333 HZ
            - description: Must be 342857143 HZ
            - description: Must be 533000000 HZ
            - description: Must be 533000000 HZ
            - description: Must be 133333333 HZ

examples:
  - |
        #include <dt-bindings/interrupt-controller/arm-gic.h>
        #include <dt-bindings/clock/qcom,gcc-ipq5018.h>
        #include <dt-bindings/reset/qcom,gcc-ipq5018.h>

        q6v5_wcss: remoteproc@cd00000 {
                compatible = "qcom,ipq5018-q6-mpd";
                #address-cells = <1>;
                #size-cells = <1>;
                ranges;
                reg = <0x0cd00000 0x4040>;
                interrupts-extended = <&intc GIC_SPI 291 IRQ_TYPE_EDGE_RISING>,
                                <&wcss_smp2p_in 0 0>,
                                <&wcss_smp2p_in 1 0>,
                                <&wcss_smp2p_in 2 0>,
                                <&wcss_smp2p_in 3 0>;
                interrupt-names = "wdog",
                                  "fatal",
                                  "ready",
                                  "handover",
                                  "stop-ack";

                qcom,smem-states = <&wcss_smp2p_out 0>,
                                   <&wcss_smp2p_out 1>;
                qcom,smem-state-names = "shutdown",
                                        "stop";

                memory-region = <&q6_region>;

                glink-edge {
                        interrupts = <GIC_SPI 179 IRQ_TYPE_EDGE_RISING>;
                        label = "rtr";
                        qcom,remote-pid = <1>;
                        mboxes = <&apcs_glb 8>;
                };

                q6_wcss_pd1: remoteproc_pd1 {
                        compatible = "qcom,ipq5018-wcss-ahb-mpd";
                        interrupts-extended = <&wcss_smp2p_in 8 0>,
                                        <&wcss_smp2p_in 9 0>,
                                        <&wcss_smp2p_in 12 0>,
                                        <&wcss_smp2p_in 11 0>;
                        interrupt-names = "fatal",
                                          "ready",
                                          "spawn-ack",
                                          "stop-ack";
                        qcom,smem-states = <&wcss_smp2p_out 8>,
                                           <&wcss_smp2p_out 9>,
                                           <&wcss_smp2p_out 10>;
                        qcom,smem-state-names = "shutdown",
                                                "stop",
                                                "spawn";
                };

                q6_wcss_pd2: remoteproc_pd2 {
                        compatible = "qcom,ipq5018-wcss-pcie-mpd";
                        interrupts-extended = <&wcss_smp2p_in 16 0>,
                                        <&wcss_smp2p_in 17 0>,
                                        <&wcss_smp2p_in 20 0>,
                                        <&wcss_smp2p_in 19 0>;
                        interrupt-names = "fatal",
                                          "ready",
                                          "spawn-ack",
                                          "stop-ack";

                        qcom,smem-states = <&wcss_smp2p_out 16>,
                                           <&wcss_smp2p_out 17>,
                                           <&wcss_smp2p_out 18>;
                        qcom,smem-state-names = "shutdown",
                                                "stop",
                                                "spawn";
                        status = "okay";
                };

                q6_wcss_pd3: remoteproc_pd3 {
                        compatible = "qcom,ipq5018-wcss-pcie-mpd";
                        interrupts-extended = <&wcss_smp2p_in 24 0>,
                                        <&wcss_smp2p_in 25 0>,
                                        <&wcss_smp2p_in 28 0>,
                                        <&wcss_smp2p_in 27 0>;
                        interrupt-names = "fatal",
                                          "ready",
                                          "spawn-ack",
                                          "stop-ack";

                        qcom,smem-states = <&wcss_smp2p_out 24>,
                                           <&wcss_smp2p_out 25>,
                                           <&wcss_smp2p_out 26>;
                        qcom,smem-state-names = "shutdown",
                                                "stop",
                                                "spawn";
                        status = "okay";
                };
        };
```
